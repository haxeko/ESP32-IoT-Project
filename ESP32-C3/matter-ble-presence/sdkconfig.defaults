## ESP32-H2/matter-presence-ld2410-learning/main/Kconfig.projbuild
```kconfig
menu "Device Information"

    config DEVICE_VENDOR_NAME
        string "Manufacturer (Basic Information VendorName)"
        default "Haxeko"

    config DEVICE_PRODUCT_NAME
        string "Model (Basic Information ProductName and ProductLabel)"
        default "Presence LD2410"
        help
            Home Assistant shows ProductLabel (else ProductName) as the model.

    config DEVICE_NAME_PREFIX
        string "Device name prefix, followed by the last 4 characters of the serial number"
        default "Presence-"
        help
            Device name: this prefix and the last 4 characters of the serial
            number (factory MAC in eFuse), e.g. "Presence-B2C3", so boards
            flashed with the same firmware get different names. Max 11
            characters.
            Written to Basic Information NodeLabel at boot when no label is
            stored yet (new board, after a factory reset); a label set from an
            app is kept. Home Assistant names the device after NodeLabel.
            Also the Bluetooth (GAP) name while waiting to be commissioned,
            seen only once connected: the Matter advertisement has no name.
            Empty: NodeLabel CONFIG_DEVICE_DISPLAY_NAME and the Bluetooth name
            "<BLE_DEVICE_NAME_PREFIX><discriminator>".

    config DEVICE_DISPLAY_NAME
        string "Name advertised before commissioning (DNS-SD)"
        default "Presence Sensor"
        help
            Name in commissionable node discovery (DNS-SD "DN"), the same for
            every board. Also the default NodeLabel when DEVICE_NAME_PREFIX is
            empty. Max 32 characters.

    config DEVICE_HARDWARE_VERSION_STRING
        string "Hardware (Basic Information HardwareVersionString)"
        default "ESP32C3-LD2410" if IDF_TARGET_ESP32C3
        default "ESP32H2-LD2410"
        help
            Shown as Hardware by controllers. Max 64 characters.

endmenu

menu "Presence Sensor Configuration"

    config LD2410_UART_RX_PIN
        int "UART RX pin (connect to LD2410 TX)"
        range 0 21 if IDF_TARGET_ESP32C3
        range 0 27
        default 3 if IDF_TARGET_ESP32C3
        default 11
        help
            ESP32-H2: avoid the strapping pins (GPIO2, GPIO3, GPIO8, GPIO9,
            GPIO25), the flash pins (GPIO15-GPIO21) and the console UART pins
            (GPIO23, GPIO24).
            ESP32-C3: avoid the strapping pins (GPIO2, GPIO8, GPIO9), the
            flash pins (GPIO11-GPIO17) and the USB pins (GPIO18, GPIO19).

    config LD2410_UART_TX_PIN
        int "UART TX pin (connect to LD2410 RX)"
        range 0 21 if IDF_TARGET_ESP32C3
        range 0 27
        default 4 if IDF_TARGET_ESP32C3
        default 12

    config PRESENCE_MAX_DISTANCE_CM
        int "Only count targets closer than (cm, 0 = use the radar's own gates)"
        range 0 800
        default 0
        help
            The LD2410 decides presence with its own per-gate sensitivity
            (default up to 6 m). A non-zero value additionally ignores targets
            further away than this distance.

    config PRESENCE_HOLD_TIME_SEC
        int "Default hold time (seconds)"
        range 1 300
        default 30
        help
            Occupancy Sensing HoldTime at first boot: how long the device keeps
            reporting "occupied" after the radar stops seeing anyone.
            Controllers (Home Assistant...) can change it later in 1-300 s;
            the new value is kept across reboots.

    config RADAR_TIMEOUT_SEC
        int "Report unoccupied when the radar sends nothing for (seconds)"
        range 1 300
        default 10

    choice STATUS_LED_TYPE
        prompt "Status LED"
        default STATUS_LED_TYPE_GPIO if IDF_TARGET_ESP32C3
        default STATUS_LED_TYPE_WS2812
        help
            Blinks blue while the device waits to be commissioned (pairing
            mode) and stays off otherwise. Blinks white when an app asks the
            device to identify itself. Empty room learning: cyan while there
            is time to leave the room, slow cyan blink while recording, then
            green for 10 s once the new thresholds are saved, or red for 10 s
            when the learning failed. A single-colour LED shows every colour
            as on.

        config STATUS_LED_TYPE_WS2812
            bool "Addressable WS2812 RGB LED (ESP32-H2-DevKitM-1: GPIO8)"

        config STATUS_LED_TYPE_GPIO
            bool "Single-colour LED on a GPIO (ESP32-C3 SuperMini: GPIO8)"

        config STATUS_LED_TYPE_NONE
            bool "None"
    endchoice

    config STATUS_LED_GPIO
        int "Status LED pin"
        depends on !STATUS_LED_TYPE_NONE
        range 0 21 if IDF_TARGET_ESP32C3
        range 0 27
        default 8

    config STATUS_LED_ACTIVE_HIGH
        bool "Status LED is on when the pin is high"
        depends on STATUS_LED_TYPE_GPIO
        default n if IDF_TARGET_ESP32C3
        default y
        help
            The blue LED of the ESP32-C3 SuperMini is on when GPIO8 is low.

    config STATUS_LED_BRIGHTNESS
        int "WS2812 brightness (1-255)"
        depends on STATUS_LED_TYPE_WS2812
        range 1 255
        default 20

    config RESET_BUTTON_GPIO
        int "Button pin (-1 = none)"
        range -1 21 if IDF_TARGET_ESP32C3
        range -1 27
        default 9
        help
            Active-low push button, GPIO9 is the BOOT button (ESP32-H2 and
            ESP32-C3).
            Double click: pairing mode (opens the commissioning window for
            15 minutes, also to add the device to a second app).
            Triple click: empty room learning, as "Learning" in Home
            Assistant.
            Hold 5 seconds: factory reset (erases the Thread network or the
            Wi-Fi credentials, and the Matter pairing).

    config PRESENCE_WIFI_MAX_TX_POWER
        int "Highest Wi-Fi transmit power (0.25 dBm, 0 = chip default)"
        depends on ENABLE_WIFI_STATION
        range 0 84
        default 0
        help
            Limits the Wi-Fi transmit power, in steps of 0.25 dBm: 34 = 8.5 dBm,
            80 = 20 dBm. Some ESP32-C3 SuperMini boards are reported to find the
            access point but fail its authentication at full power (log
            "wifi:state: auth -> init"); 8.5 dBm is the value most often
            reported to fix it. It did not on the board this was tested with,
            where the cause was beamforming on the access point. A lower power
            also means a shorter range, so keep the board within reach of the
            access point. The chip rounds
            the value down to one of its steps (8, 20, 28, 34, 44, 52, 56, 60,
            66, 72, 80); values from 1 to 7 count as 8. 0 keeps the chip default
            (about 20 dBm).

endmenu

menu "Empty Room Learning"

    config LD2410_LEARN_DELAY_SEC
        int "Delay before recording (seconds)"
        range 0 120
        default 20
        help
            Time to leave the room after choosing "Learning" in Home Assistant
            or a triple click on the button (the LED is cyan meanwhile).
            The room must stay empty while the radar is recorded: the radar
            sees about 6 m, also through wooden doors and thin walls.

    config LD2410_LEARN_DURATION_SEC
        int "Recording time (seconds)"
        range 10 300
        default 60
        help
            How long the per-gate energy of the empty room is recorded (the
            LED blinks cyan slowly meanwhile). Long enough for a fan or an
            air conditioner that sweeps the room to pass a few times.

    config LD2410_LEARN_RADAR_AUTO
        bool "Let the radar measure the room itself when it can"
        default y
        help
            LD2410B/C radars with newer firmware measure the background noise
            of every gate themselves and set their moving and still
            thresholds (command 0x000B of the LD2410C serial protocol V1.09,
            the "Auto" button of the HLKRadarTool app; Hi-Link does not say
            from which radar firmware on). With this option the learning asks the radar
            first: it waits 10 s, then measures for the recording time. Hi-Link
            does not document how the thresholds are computed; they may be
            more sensitive than the factory defaults. A radar that refuses the
            command is learned by the ESP32 as below (noise percentile, margin,
            highest raise).

    config LD2410_LEARN_PERCENTILE
        int "Noise percentile (%)"
        range 50 100
        default 95
        help
            Noise of each gate = the energy that this share of the recorded
            reports stays at or below: the highest (100 - value) % of the
            reports are left out, so a short burst (someone walking past the
            door, a door closing) does not raise the threshold. At 95 % and
            60 s of recording, bursts of less than 3 s in total are left out,
            while something that moves more than 5 % of the time (fan,
            curtain) is learned. 100 takes the highest energy recorded, like
            older firmware.

    config LD2410_LEARN_MARGIN
        int "Margin above the recorded noise (energy 0-100)"
        range 0 50
        default 10
        help
            New threshold of each gate = recorded noise + this margin, never
            below the LD2410 factory default, at most the factory default +
            the highest raise below, and at most 100 (gate ignored).

    config LD2410_LEARN_MAX_RAISE
        int "Highest raise above the factory threshold (energy 0-100)"
        range 0 100
        default 30
        help
            A learned threshold is at most the factory default + this value,
            so a person or something moving during the recording cannot make
            a gate deaf. A gate limited this way is logged as a warning: what
            moved there may still be reported as presence. 100: no limit, a
            gate can be raised up to 100 (ignored).

endmenu

menu "Thread Diagnostics"
    depends on OPENTHREAD_ENABLED

    config THREAD_DIAG_LOG
        bool "Log Thread addresses and SRP state until commissioned"
        default y
        help
            Every 10 s, until commissioning completes, log the Thread role, IPv6 addresses
            (link-local / mesh-local / OMR), on-mesh prefixes from the Border Router and
            the SRP host/service registration state. Helps find why a phone cannot reach
            the device after BLE provisioning. Stops once the device is commissioned.

endmenu

menu "Identity Diagnostics and Setup Code"

    config IDENTITY_DIAG_PERIOD_SEC
        int "Identity / network / Matter diagnostics period (seconds, 0 = off)"
        range 0 86400
        default 300
        help
            Logs (tag "id_diag") at boot, at this period and on Thread or Wi-Fi,
            fabric and session events: reset reason, factory MAC, serial number,
            UniqueID, discriminator, Matter fabrics (index, node ID, fabric ID,
            compressed fabric ID, controller vendor), CASE sessions, subscriptions
            and NVS usage.
            ESP32-H2: IEEE EUI-64, Thread role, RLOC16, extended address, ML-EID,
            partition ID, leader, network name, Ext PAN ID, channel, neighbours,
            MLE counters, on-mesh prefixes, SRP server and registration state.
            ESP32-C3: Wi-Fi station MAC, SSID, BSSID, channel, RSSI, power save,
            IPv4 address and IPv6 addresses per kind.
            Never logs the setup passcode, private keys, the Thread network key
            or the Wi-Fi password.

    config IDENTITY_DIAG_SUBSCRIPTION_LOG
        bool "Log every subscription request, establishment and termination"
        default y
        help
            One line per subscription event with the fabric index, the controller
            node ID and the negotiated report intervals. Only observes: the
            subscriptions and their intervals are not changed.

    config PRINT_ONBOARDING_CODES
        bool "Log the QR code and manual pairing code when pairing is possible"
        default y
        help
            At boot when not commissioned, and when the button opens the pairing
            window. Development aid: the QR code contains the setup passcode, turn
            this off in production builds.

    config UNIQUE_SETUP_CODE
        bool "Per-board random setup code stored in flash"
        depends on CUSTOM_COMMISSIONABLE_DATA_PROVIDER
        default y
        help
            Enabled by sdkconfig.defaults.unique_setup (see README). Each board
            generates its own passcode, discriminator and SPAKE2+ salt on first use,
            computes the SPAKE2+ verifier and stores them in the partition below.
            Kept across reboots, OTA, factory reset and flashing the merged or app
            image; regenerated only after erase-flash.

    config UNIQUE_SETUP_CODE_PARTITION
        string "Flash partition for the per-board setup code"
        depends on UNIQUE_SETUP_CODE
        default "fctry"
        help
            NVS data partition, namespace "setup-code". "fctry" is otherwise unused
            by these builds and lies outside the area written by the merged image.

endmenu

menu "Memory Monitor"

    config MEM_MONITOR_PERIOD_SEC
        int "Memory log period (seconds, 0 = only at boot)"
        range 0 86400
        default 600
        help
            Logs the free heap (now, lowest since boot, largest block) and the
            unused stack of the main tasks at boot and then at this period,
            as a warning when the heap drops below 16 KB or a stack below
            512 bytes.

endmenu
```
