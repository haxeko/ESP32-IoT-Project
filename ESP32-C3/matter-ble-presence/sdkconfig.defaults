## ESP32-C3/matter-pm25-sensor/main/Kconfig.projbuild
```kconfig
menu "Device Information"

    config DEVICE_VENDOR_NAME
        string "Manufacturer (Basic Information VendorName)"
        default "Haxeko"

    config DEVICE_PRODUCT_NAME
        string "Model (Basic Information ProductName)"
        default "PM5003"

    config DEVICE_DISPLAY_NAME
        string "Device name (Basic Information NodeLabel / ProductLabel)"
        default "Air Quality Sensor"
        help
            Default name that controllers show when the device is added.
            Max 32 characters. It can be renamed later in the app.

    config DEVICE_HARDWARE_VERSION_STRING
        string "Hardware (Basic Information HardwareVersionString)"
        default "ESP32C3-SDS011" if PM_SENSOR_MODEL_SDS011
        default "ESP32C3-PMS5003"
        help
            Hardware description that controllers show for the device, e.g.
            "Hardware" in Home Assistant. Max 64 characters.

endmenu

menu "PM2.5 Sensor Configuration"

    choice PM_SENSOR_MODEL
        prompt "PM sensor model"
        default PM_SENSOR_MODEL_PMS
        help
            UART particulate matter sensor connected to the ESP32-C3.

        config PM_SENSOR_MODEL_PMS
            bool "Plantower PMS5003 / PMS7003 / PMSA003"

        config PM_SENSOR_MODEL_SDS011
            bool "Nova Fitness SDS011 / SDS021"
    endchoice

    config PM_SENSOR_UART_RX_PIN
        int "UART RX pin (connect to sensor TX)"
        default 6
        help
            GPIO6 on the PCB: connector J2B pin 3, the sensor TX.

    config PM_SENSOR_UART_TX_PIN
        int "UART TX pin (connect to sensor RX)"
        default 7
        help
            GPIO7 on the PCB: connector J2B pin 4, the sensor RX.

    config PM_SENSOR_PMS_PERIOD_SEC
        int "PMS measurement period (seconds, 0 = continuous)"
        depends on PM_SENSOR_MODEL_PMS
        range 0 3600
        default 300
        help
            When non-zero, the PMS sensor sleeps (fan and laser off) between
            measurements: it is woken up, warmed up for 30 seconds, sampled
            for 5 seconds and put back to sleep. This greatly extends its life.
            Values below 60 are treated as 60.

    config PM_SENSOR_REPORT_INTERVAL_SEC
        int "Report interval in continuous mode (seconds)"
        range 1 3600
        default 10
        help
            In continuous mode, samples received from the sensor are averaged
            over this interval and then published.

    config PM_SENSOR_SDS011_WORK_PERIOD_MIN
        int "SDS011 working period (minutes, 0 = continuous)"
        depends on PM_SENSOR_MODEL_SDS011
        range 0 30
        default 0
        help
            In periodic mode the SDS011 sleeps and wakes up every N minutes,
            runs the fan for 30 seconds and sends one measurement. This
            greatly extends the life of the laser and fan.

endmenu

menu "CO2 Sensor Configuration"

    choice CO2_SENSOR
        prompt "CO2 sensor"
        default CO2_SENSOR_SCD4X
        help
            CO2 sensor on the I2C bus of the OLED (same SDA/SCL pins). Its
            value is shown on the OLED and sent to Matter (Carbon Dioxide
            Concentration Measurement cluster, in ppm). The air quality level
            (OLED label, LED color, Matter AirQuality) still follows PM2.5
            only.

        config CO2_SENSOR_NONE
            bool "None"

        config CO2_SENSOR_SCD4X
            bool "Sensirion SCD40 / SCD41 (I2C address 0x62)"
    endchoice

    config CO2_SENSOR_REPORT_INTERVAL_SEC
        int "CO2 report interval (seconds)"
        depends on CO2_SENSOR_SCD4X
        range 5 3600
        default 30
        help
            The sensor measures every 5 seconds; its measurements are
            averaged over this interval and then shown and published.

endmenu

menu "Local Display and Indicators"

    config OLED_SDA_PIN
        int "I2C SDA pin (OLED and CO2 sensor)"
        default 4

    config OLED_SCL_PIN
        int "I2C SCL pin (OLED and CO2 sensor)"
        default 5

    config OLED_I2C_ADDRESS
        hex "OLED I2C address"
        default 0x3C

    choice OLED_CONTROLLER
        prompt "OLED controller"
        default OLED_CONTROLLER_SSD1306
        help
            0.96" modules are usually SSD1306, 1.3" modules SH1106. With the
            wrong one, the image is shifted by 2 pixels and one edge shows
            garbage columns.

        config OLED_CONTROLLER_SSD1306
            bool "SSD1306 (0.96\", the PCB)"

        config OLED_CONTROLLER_SH1106
            bool "SH1106 (1.3\")"
    endchoice

    config OLED_ROTATE_180
        bool "Rotate OLED 180 degrees"
        default n
        help
            Off: upright with the module's pin header on top, as on the PCB.
            On: for a module mounted with the pin header at the bottom.

    config STATUS_LED_GPIO
        int "WS2812 data pin"
        default 3

    config STATUS_LED_COUNT
        int "Number of WS2812 LEDs"
        range 1 64
        default 6

    config STATUS_LED_BRIGHTNESS
        int "WS2812 brightness (%)"
        range 1 100
        default 50

    config DISPLAY_BUTTON_GPIO
        int "Display on/off button GPIO (-1 = no button)"
        range -1 21
        default -1
        help
            Optional push button between this GPIO and GND (the internal
            pull-up is used). Each press turns the OLED off when it is on, and
            on when it is off. The choice is saved and applies again after a
            restart. The OLED is still on during start-up (until the first
            measurement + 5 s), during a factory reset and in pairing mode.
            Without a button (-1, the PCB has none) the OLED stays on.

            Free on an ESP32-C3 with the PCB wiring: GPIO0, 1, 20 (GPIO10 is
            the main button). Do not use a strapping pin (GPIO2, 8, 9), the
            flash pins (GPIO11 to 17), the USB pins (GPIO18, 19) or GPIO21
            (boot log output).

endmenu

menu "Button"

    config BUTTON_GPIO
        int "Button GPIO (-1 = no button)"
        range -1 21
        default 10
        help
            Push button between this GPIO and GND (the internal pull-up is
            used):
            - Hold it for 5 seconds, until the OLED shows 0, then release it:
              factory reset. The device erases its Wi-Fi and Matter pairing
              and restarts, ready to be paired again. Releasing it earlier
              cancels.
            - Press it twice: pairing mode. The device can be paired for 5
              minutes (again, or with one more controller), and the OLED
              shows its pairing code.
            - Press it 4 times: the OLED switches between PM2.5 alone and
              PM2.5 + CO2 (with a CO2 sensor). The choice is kept.

            Without a button (-1), factory reset by powering the device on 5
            times in a row, each time for less than 10 seconds (this also
            works with the button).

            Free on an ESP32-C3 with the PCB wiring: GPIO0, 1, 10, 20. Do not
            use a strapping pin (GPIO2, 8, 9), the flash pins (GPIO11 to 17),
            the USB pins (GPIO18, 19) or GPIO21 (boot log output).

    config FACTORY_RESET_POWER_CYCLES
        int "Power cycles in a row that factory reset the device (0 = off)"
        range 0 20
        default 5
        help
            Powering the device on this many times in a row, each time for
            less than 10 seconds, factory resets it. 0 turns this off (1 and
            2 are refused: a single power glitch would do it).

            The firmware cannot tell the user doing this from a supply that
            drops out in bursts (loose plug, power bank that switches off,
            supply too weak for the Wi-Fi peaks): with such a supply and a
            button to reset the device, turn it off.

endmenu

menu "Diagnostics"

    config APP_DIAG
        bool "Commissioning and sensor diagnostics"
        default n
        select FREERTOS_USE_TRACE_FACILITY
        select FREERTOS_GENERATE_RUN_TIME_STATS
        help
            To find why commissioning or a sensor fails. Adds to the log:
            - the resets counted by reason (power-on, brown-out, watchdog,
              panic...), kept in NVS across the resets themselves;
            - each step of a commissioning (BLE advertising, BLE connection,
              PASE, Wi-Fi, IP address, CASE, complete) with the free heap;
            - every few seconds: heap, stack headroom and CPU share of every
              task, UART / I2C transfer and error counters of the sensors
              and the OLED, Wi-Fi signal.
            Pressing the button 3 times clears the reset counters.

            Costs about 5 KB of RAM. The sdkconfig.diag overlay turns it on
            together with a console on UART0 and the Matter shell, see
            docs/commissioning-test-plan.md.

    config APP_DIAG_LOG_INTERVAL_SEC
        int "Status log interval (seconds)"
        depends on APP_DIAG
        range 1 600
        default 10

    config APP_DIAG_OLED
        bool "Reset counters and commissioning stage on the OLED"
        depends on APP_DIAG
        default y
        help
            The bottom row of the OLED shows e.g. "N3 B2 W0 P0 S4" instead of
            the air quality level: resets counted (N), of which brown-outs
            (B), watchdog resets (W) and panics (P), and the furthest
            commissioning stage since boot (S: 1 BLE advertising, 2 BLE
            connected, 3 PASE, 4 Wi-Fi, 5 IP address, 6 CASE, 7 complete).
            Readable without a console.

    config APP_DIAG_DISABLE_PM_SENSOR
        bool "Do not start the PM sensor driver"
        depends on APP_DIAG
        default n
        help
            The sensor can stay plugged in: its UART is left alone, so it is
            never told to sleep and its fan keeps running. Tells a fault of
            the driver from one of the hardware (supply, radio).

    config APP_DIAG_DISABLE_CO2_SENSOR
        bool "Do not start the CO2 sensor driver"
        depends on APP_DIAG && CO2_SENSOR_SCD4X
        default n
        help
            The sensor can stay plugged in: nothing is sent to it, so it does
            not measure (and does not draw its measurement current peaks).
            The Matter CO2 cluster stays, with no value.

endmenu
```
