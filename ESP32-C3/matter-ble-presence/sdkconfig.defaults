## ESP32-C3/matter-wifi/matter-energy-bl0942/main/Kconfig.projbuild
```kconfig
menu "Device Information"

    config DEVICE_VENDOR_NAME
        string "Manufacturer (Basic Information VendorName)"
        default "Haxeko"
        help
            Shown as Manufacturer by Apple Home, Google Home, Home Assistant... Max 32 characters.

    config DEVICE_PRODUCT_NAME
        string "Model (Basic Information ProductName)"
        default "ESP32C3 BL0942"
        help
            Shown as Model. Max 32 characters.

    config DEVICE_DISPLAY_NAME
        string "Device name (Basic Information NodeLabel / ProductLabel)"
        default "Energy Plug"
        help
            Default name that controllers show when the device is added.
            Max 32 characters. It can be renamed later in the app.

endmenu

menu "Relay Configuration"

    config RELAY_GPIO
        int "Relay GPIO number"
        range 0 21
        default 5
        help
            GPIO that drives the relay module.

    config RELAY_ACTIVE_LEVEL
        int "Relay active level (1 = active-high, 0 = active-low)"
        range 0 1
        default 1
        help
            Level written to the relay GPIO to turn the relay ON.
            Many cheap optocoupled relay boards are active-low: set 0 for those.

endmenu

menu "BL0942 Power Meter"

    config BL0942_ENABLE
        bool "Enable BL0942 power metering"
        default y
        help
            Read active power / voltage / current / energy from a BL0942 (UART) and
            expose them over Matter (Electrical Power + Energy Measurement).

    config BL0942_UART_PORT
        int "UART port"
        depends on BL0942_ENABLE
        range 0 1
        default 1
        help
            UART0 is normally used for the log console.

    config BL0942_UART_RX_GPIO
        int "ESP32 RX GPIO (connect to BL0942 TX)"
        depends on BL0942_ENABLE
        range 0 21
        default 0

    config BL0942_UART_TX_GPIO
        int "ESP32 TX GPIO (connect to BL0942 RX)"
        depends on BL0942_ENABLE
        range 0 21
        default 1

    config BL0942_UART_BAUD
        int "Baud rate"
        depends on BL0942_ENABLE
        default 9600
        help
            Initial baud rate: 4800 when the BL0942 SCLK_BPS pin is tied low, 9600 when high.
            If the BL0942 does not answer, the driver alternates 9600/4800 and
            re-runs the BL0942 setup (soft reset + MODE) until a valid packet is received.

    config BL0942_ADDRESS
        int "Device address (A1/A2 pins)"
        depends on BL0942_ENABLE
        range 0 3
        default 0

    config BL0942_VOLTAGE_REF
        string "Voltage reference (LSB per V)"
        depends on BL0942_ENABLE
        default "15873.35944"
        help
            V = V_RMS / VOLTAGE_REF. Default matches the common module
            (5 x 390k + 510R divider, 1 mOhm shunt).

    config BL0942_CURRENT_REF
        string "Current reference (LSB per A)"
        depends on BL0942_ENABLE
        default "251213.46469"
        help
            I = I_RMS / CURRENT_REF.

    config BL0942_POWER_REF
        string "Power reference (LSB per W)"
        depends on BL0942_ENABLE
        default "596"
        help
            P = WATT / POWER_REF.

    config BL0942_ENERGY_REF
        string "Energy reference (CF pulses per kWh), 0 = derive from POWER_REF"
        depends on BL0942_ENABLE
        default "0"
        help
            E(kWh) = CF_CNT / ENERGY_REF. "0" uses POWER_REF * 3600000 / 419430.4.

    config BL0942_POWER_CAL_PERMILLE
        int "Power calibration factor (per mille, 1000 = x1.000)"
        depends on BL0942_ENABLE
        default 1000

    config BL0942_VOLTAGE_CAL_PERMILLE
        int "Voltage calibration factor (per mille)"
        depends on BL0942_ENABLE
        default 1000

    config BL0942_CURRENT_CAL_PERMILLE
        int "Current calibration factor (per mille)"
        depends on BL0942_ENABLE
        default 1000

    config BL0942_UPDATE_INTERVAL_MS
        int "Update interval (ms)"
        depends on BL0942_ENABLE
        range 500 10000
        default 2000

endmenu

menu "Wi-Fi"

    config APP_WIFI_POWER_SAVE_OFF
        bool "Keep the Wi-Fi radio awake once commissioned (no power save)"
        default y
        help
            ESP-IDF lets the Wi-Fi radio sleep between beacons by default (modem sleep, WIFI_PS_MIN_MODEM):
            multicast frames wait for the next DTIM beacon and can get lost with some routers. Matter
            controllers find the device with multicast (mDNS, IPv6 neighbor discovery), so a sleeping radio
            can make it show "No Response". The plug is mains powered: keep the radio awake. Applied once BLE
            is off (after commissioning, or at boot when already commissioned). Uses a few tens of mA more.
            Say n to keep the ESP-IDF default (modem sleep).

    choice APP_WIFI_TX_POWER
        prompt "Maximum Wi-Fi transmit power"
        default APP_WIFI_TX_POWER_20
        help
            Many ESP32-C3 SuperMini boards have a poorly tuned antenna: at full power their Wi-Fi connection
            fails or keeps dropping, and lowering the transmit power (usually to 8.5 dBm) fixes it. A lower
            power also means less range: keep the router close enough.

        config APP_WIFI_TX_POWER_20
            bool "20 dBm (ESP-IDF default)"
        config APP_WIFI_TX_POWER_15
            bool "15 dBm"
        config APP_WIFI_TX_POWER_13
            bool "13 dBm"
        config APP_WIFI_TX_POWER_11
            bool "11 dBm"
        config APP_WIFI_TX_POWER_8_5
            bool "8.5 dBm (ESP32-C3 SuperMini fix)"
    endchoice

    config APP_WIFI_TX_POWER_QUARTER_DBM
        int
        default 60 if APP_WIFI_TX_POWER_15
        default 52 if APP_WIFI_TX_POWER_13
        default 44 if APP_WIFI_TX_POWER_11
        default 34 if APP_WIFI_TX_POWER_8_5
        default 80
        help
            Value for esp_wifi_set_max_tx_power(), in 0.25 dBm. 80 (20 dBm) leaves the ESP-IDF default.

endmenu
```

## ESP32-C3/matter-wifi/matter-ens160-aht21/main/Kconfig.projbuild
```kconfig
menu "Device Information"

    config DEVICE_VENDOR_NAME
        string "Manufacturer (Basic Information VendorName)"
        default "Haxeko"
        help
            Max 32 characters.

    config DEVICE_PRODUCT_NAME
        string "Model (Basic Information ProductName and ProductLabel)"
        default "ENS160 AHT21"
        help
            Home Assistant shows ProductLabel (else ProductName) as the model.
            Max 32 characters.

    config DEVICE_NAME_PREFIX
        string "Device name prefix, followed by the last 4 characters of the serial number"
        default "ENS160-"
        help
            Device name: this prefix and the last 4 characters of the serial
            number (factory MAC in eFuse), e.g. "ENS160-B2C4", so boards
            flashed with the same firmware get different names. Max 11
            characters.
            Written to Basic Information NodeLabel at boot when no label is
            stored yet (new board, after a factory reset); a label set from an
            app is kept. Home Assistant names the device after NodeLabel.
            Also the Bluetooth (GAP) name while waiting to be commissioned,
            seen only once connected: the Matter advertisement has no name.
            Empty: NodeLabel DEVICE_DISPLAY_NAME and the Bluetooth name
            "<BLE_DEVICE_NAME_PREFIX><discriminator>".

    config DEVICE_DISPLAY_NAME
        string "Name advertised before commissioning (DNS-SD)"
        default "ENS160 Sensor"
        help
            Name in commissionable node discovery (DNS-SD "DN"), the same for
            every board. Also the NodeLabel when DEVICE_NAME_PREFIX is empty.
            Max 32 characters.

    config DEVICE_HARDWARE_VERSION_STRING
        string "Hardware (Basic Information HardwareVersionString)"
        default "ESP32C3-ENS160-AHT21"
        help
            Shown as Hardware by controllers. Max 64 characters.

endmenu

menu "Board"

    config BOARD_NAME
        string "Board name in the boot log"
        default "ESP32-C3 SuperMini"
        help
            Only shown in the log ("Target esp32c3, board ..."). The pins are
            the options below.

    config SENSOR_I2C_SDA_GPIO
        int "I2C SDA pin (SDA of the ENS160 + AHT21 module)"
        range 0 21
        default 5
        help
            ESP32-C3 SuperMini: GPIO5. Not the flash pins (GPIO11-GPIO17) or
            the USB pins (GPIO18, GPIO19): the build fails on them. Avoid the
            strapping pins GPIO2, GPIO8 and GPIO9 (LED and BOOT button of the
            SuperMini).

    config SENSOR_I2C_SCL_GPIO
        int "I2C SCL pin (SCL of the ENS160 + AHT21 module)"
        range 0 21
        default 6
        help
            ESP32-C3 SuperMini: GPIO6. Same restrictions as the SDA pin.

    config STATUS_LED_GPIO
        int "Status LED pin (-1 = none)"
        range -1 21
        default 8
        help
            Single-colour LED, the blue LED of the ESP32-C3 SuperMini on GPIO8.
            Blinks fast while an app asks the device to identify itself, slowly
            (1 s on, 1 s off) while waiting to be commissioned (pairing mode),
            flashes briefly every 2 seconds when the AHT21 or the ENS160 does
            not answer, and stays off otherwise.

    config STATUS_LED_ACTIVE_HIGH
        bool "Status LED is on when the pin is high"
        default n
        help
            The blue LED of the ESP32-C3 SuperMini is on when GPIO8 is low.

    config RESET_BUTTON_GPIO
        int "Button pin (-1 = none)"
        range -1 21
        default 9
        help
            Active-low push button, GPIO9 is the BOOT button of the SuperMini.
            Double click: pairing mode (opens the commissioning window for
            15 minutes, also to add the device to a second app).
            Hold 5 seconds: factory reset (erases the Wi-Fi credentials and the
            Matter pairing, then restarts, ready to be commissioned again).

endmenu

menu "ENS160 + AHT21 Sensor"

    config SENSOR_PERIOD_SEC
        int "Reading period (seconds)"
        range 2 300
        default 10
        help
            Both sensors are read every period. The ENS160 measures once a
            second on its own; the AHT21 measures when asked (more often than
            every 2 seconds would warm it up). The values are written to
            Matter when they change by more than the noise of the sensors:
            0.1 C, 0.5 %RH, 10 ppb TVOC, 10 ppm eCO2, any air quality change.

    config SENSOR_TEMPERATURE_OFFSET_TENTHS
        int "Temperature offset (tenths of a degree Celsius)"
        range -100 100
        default 0
        help
            Added to the temperature of the AHT21, e.g. -15 for -1.5 C. On the
            ENS160 + AHT21 module the AHT21 sits next to the heated ENS160 and
            often reads 1 to 3 C too warm: compare with a thermometer after an
            hour, away from the ESP32 (which warms up as well), and set the
            difference here. The humidity is corrected with it (same air at the
            corrected temperature).

    config ENS160_REPORT_WHILE_WARMING_UP
        bool "Send the ENS160 values during its warm-up and initial start-up"
        default n
        help
            The ENS160 flags its values as not valid yet for about 3 minutes
            after each power-on (warm-up) and during the first hour of a new
            sensor (initial start-up). Off: Matter gets no air quality, TVOC
            and eCO2 (Unknown / null) until they are valid. On: they are sent
            anyway, e.g. to check the wiring of a new sensor in the app.

    config SENSOR_ECO2_AS_CO2
        bool "Expose the eCO2 of the ENS160 as a CO2 concentration"
        default y
        help
            Adds a Carbon Dioxide Concentration Measurement cluster with the
            eCO2 of the ENS160 (ppm). eCO2 is estimated from the VOCs, not
            measured like a real (NDIR) CO2 sensor does: turn this off when the
            apps should not show it as CO2. Changing it changes the clusters of
            endpoint 3: remove and add the device again in the apps.

endmenu
```
