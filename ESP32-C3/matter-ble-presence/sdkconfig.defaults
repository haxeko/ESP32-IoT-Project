## ESP32-C3/matter-wifi/matter-lift-lamp/main/Kconfig.projbuild
```kconfig
menu "Device Information"

    config DEVICE_VENDOR_NAME
        string "Manufacturer (Basic Information VendorName)"
        default "Haxeko"
        help
            Shown as Manufacturer by Apple Home, Google Home, Home Assistant... Max 32 characters.

    config DEVICE_PRODUCT_NAME
        string "Model (Basic Information ProductName)"
        default "Vibe Lift Lamp"
        help
            Shown as Model. Max 32 characters.

    config DEVICE_DISPLAY_NAME
        string "Device name (Basic Information NodeLabel / ProductLabel)"
        default "Vibe Lift Lamp"
        help
            Default name that controllers show when the device is added.
            Max 32 characters. It can be renamed later in the app.

endmenu

menu "WS2812 RGB Light"

    config LED_GPIO
        int "WS2812 data GPIO"
        range 0 21
        default 4
        help
            GPIO connected to DIN of the first WS2812.

    config LED_COUNT
        int "Number of WS2812 LEDs"
        range 1 1024
        default 30

    config LED_FIXED_BRIGHTNESS_PERCENT
        int "Fixed intensity of every lit LED (%)"
        range 1 100
        default 30
        help
            Each lit LED always shines at this intensity. The brightness set from
            Matter (0-100 %) does not dim the LEDs: it sets the height of the lamp, and
            the LEDs the moving part exposes are lit (100 % = all LEDs, 50 % = half).

    config LED_FILL_REVERSE
        bool "Light LEDs from the end of the strip"
        default n
        help
            By default LEDs are lit starting at the first LED (next to DIN), which must
            be at the bottom of the travel (exposed first when the lamp opens). Say y if
            the strip is mounted with DIN at the top.

endmenu

menu "Lift motor (step motor)"

    config MOTOR_ENABLED
        bool "Step motor moves the upper part"
        default y
        help
            A step motor driver (TMC2209, A4988, DRV8825: STEP/DIR/EN inputs) moves the
            lamp's upper part on a lead screw, with an end stop at the closed position.
            Without it the LEDs follow the brightness like a plain light.

    if MOTOR_ENABLED

    config MOTOR_STEP_GPIO
        int "STEP GPIO"
        range 0 21
        default 5

    config MOTOR_DIR_GPIO
        int "DIR GPIO"
        range 0 21
        default 6

    config MOTOR_EN_GPIO
        int "EN GPIO (active low, -1 = not connected)"
        range -1 21
        default 7
        help
            Turns the driver output off while the lamp is not homed, after a fault, and
            at rest when "Driver off at rest" is set. Put a 10 kOhm pull-up to 3.3 V on
            it so the driver stays off while the ESP32-C3 boots.
            With -1, wire the driver's EN pin to GND: TMC2209 modules pull EN up, so an
            open EN keeps the driver off. The firmware then cannot let go of the motor
            after a fault.

    config MOTOR_ENDSTOP_GPIO
        int "End stop GPIO"
        range 0 21
        default 3
        help
            Switch to GND, pressed when the lamp is closed. The internal pull-up is on;
            an external 10 kOhm pull-up to 3.3 V is better with long wires.

    config MOTOR_ENDSTOP_NC
        bool "End stop is normally closed (NC)"
        default y
        help
            NC (recommended): the contact opens when pressed, so a broken wire reads as
            "pressed". At boot, homing then stops with an error instead of driving into
            the base; later, a press read more than 3 mm above the closed position (or
            not released when opening) stops the motor and homes again, which finds the
            broken wire and turns the motor off. With NO, a broken wire is never seen as
            pressed: homing pushes against the base for the whole search.
            Say n for a normally open (NO) contact.

    config MOTOR_DIR_INVERT
        bool "Invert the direction"
        default n
        help
            Say y if the lamp moves down when it should open.

    config MOTOR_STEPS_PER_REV
        int "Full steps per motor revolution"
        range 20 1000
        default 200
        help
            200 for a 1.8 degree motor (NEMA17), 400 for 0.9 degree.

    config MOTOR_MICROSTEPS
        int "Microsteps per full step"
        range 1 256
        default 8
        help
            Must match the driver: TMC2209 with MS1 and MS2 low (module default) = 8.

    config MOTOR_LEAD_UM
        int "Lead screw travel per revolution (um)"
        range 100 100000
        default 8000
        help
            T8 lead screw: 8000 (8 mm per turn, 4 starts) or 2000 (2 mm per turn,
            self-locking).

    config MOTOR_TRAVEL_MM
        int "Travel from closed to fully open (mm)"
        range 5 2000
        default 150
        help
            Length of the strip part that the upper part can expose: the LEDs are
            spread over this travel.

    config MOTOR_SPEED_MM_S
        int "Speed (mm/s)"
        range 1 200
        default 10
        help
            Limited to 10000 steps/s by the firmware.

    config MOTOR_ACCEL_MM_S2
        int "Acceleration (mm/s^2)"
        range 1 2000
        default 20

    config MOTOR_HOMING_SPEED_MM_S
        int "Homing speed (mm/s)"
        range 1 100
        default 8
        help
            Speed towards the end stop at boot and for the last 10 mm of every closing.
            The second, precise touch at boot runs at a quarter of it. Limited to 10000
            steps/s like the speed.

    config MOTOR_IDLE_OFF_MS
        int "Driver off at rest after (ms, 0 = keep holding)"
        range 0 600000
        default 0
        help
            0 keeps the motor energised at rest (holding torque). With a self-locking
            lead screw (2 mm per turn) the driver can be turned off to save power and
            heat, e.g. 2000. With an 8 mm lead the upper part may slide down when off.

    endif

endmenu

menu "Wi-Fi"

    config APP_WIFI_POWER_SAVE_OFF
        bool "Keep the Wi-Fi radio awake once commissioned (no power save)"
        default y
        help
            ESP-IDF lets the Wi-Fi radio sleep between beacons by default (modem sleep, WIFI_PS_MIN_MODEM):
            multicast frames wait for the next DTIM beacon and can get lost with some routers. Matter
            controllers find the light with multicast (mDNS, IPv6 neighbor discovery), so a sleeping radio
            can make the light show "No Response". The light is mains powered: keep the radio awake. Applied
            once BLE is off (after commissioning, or at boot when already commissioned). Uses a few tens of
            mA more.
            Say n to keep the ESP-IDF default (modem sleep).

    choice APP_WIFI_TX_POWER
        prompt "Maximum Wi-Fi transmit power"
        default APP_WIFI_TX_POWER_20
        help
            Many ESP32-C3 SuperMini boards have a poorly tuned antenna: at full power their Wi-Fi connection
            fails or keeps dropping, and lowering the transmit power (usually to 8.5 dBm) fixes it. A lower
            power also means less range: keep the router close enough.

        config APP_WIFI_TX_POWER_20
            bool "20 dBm (ESP-IDF default)"
        config APP_WIFI_TX_POWER_15
            bool "15 dBm"
        config APP_WIFI_TX_POWER_13
            bool "13 dBm"
        config APP_WIFI_TX_POWER_11
            bool "11 dBm"
        config APP_WIFI_TX_POWER_8_5
            bool "8.5 dBm (ESP32-C3 SuperMini fix)"
    endchoice

    config APP_WIFI_TX_POWER_QUARTER_DBM
        int
        default 60 if APP_WIFI_TX_POWER_15
        default 52 if APP_WIFI_TX_POWER_13
        default 44 if APP_WIFI_TX_POWER_11
        default 34 if APP_WIFI_TX_POWER_8_5
        default 80
        help
            Value for esp_wifi_set_max_tx_power(), in 0.25 dBm. 80 (20 dBm) leaves the ESP-IDF default.

endmenu

menu "Button"

    config APP_BUTTON_GPIO
        int "Button GPIO (active low)"
        range -1 21
        default 9
        help
            Short press: toggle the light. Hold 5 s, then release: factory reset.
            GPIO9 is the BOOT button on ESP32-C3 boards (SuperMini, DevKitM-1). -1 disables the button.

endmenu
```

## ESP32-C3/matter-wifi/matter-pm25-sensor/main/Kconfig.projbuild
```kconfig
menu "Device Information"

    config DEVICE_VENDOR_NAME
        string "Manufacturer (Basic Information VendorName)"
        default "Haxeko"

    config DEVICE_PRODUCT_NAME
        string "Model (Basic Information ProductName)"
        default "PM5003"

    config DEVICE_DISPLAY_NAME
        string "Device name (Basic Information NodeLabel / ProductLabel)"
        default "Air Quality Sensor"
        help
            Default name that controllers show when the device is added.
            Max 32 characters. It can be renamed later in the app.

endmenu

menu "PM2.5 Sensor Configuration"

    choice PM_SENSOR_MODEL
        prompt "PM sensor model"
        default PM_SENSOR_MODEL_PMS
        help
            UART particulate matter sensor connected to the ESP32-C3.

        config PM_SENSOR_MODEL_PMS
            bool "Plantower PMS5003 / PMS7003 / PMSA003"

        config PM_SENSOR_MODEL_SDS011
            bool "Nova Fitness SDS011 / SDS021"
    endchoice

    config PM_SENSOR_UART_RX_PIN
        int "UART RX pin (connect to sensor TX)"
        default 20

    config PM_SENSOR_UART_TX_PIN
        int "UART TX pin (connect to sensor RX)"
        default 21

    config PM_SENSOR_PMS_PERIOD_SEC
        int "PMS measurement period (seconds, 0 = continuous)"
        depends on PM_SENSOR_MODEL_PMS
        range 0 3600
        default 300
        help
            When non-zero, the PMS sensor sleeps (fan and laser off) between
            measurements: it is woken up, warmed up for 30 seconds, sampled
            for 5 seconds and put back to sleep. This greatly extends its life.
            Values below 60 are treated as 60.

    config PM_SENSOR_REPORT_INTERVAL_SEC
        int "Report interval in continuous mode (seconds)"
        range 1 3600
        default 10
        help
            In continuous mode, samples received from the sensor are averaged
            over this interval and then published.

    config PM_SENSOR_SDS011_WORK_PERIOD_MIN
        int "SDS011 working period (minutes, 0 = continuous)"
        depends on PM_SENSOR_MODEL_SDS011
        range 0 30
        default 0
        help
            In periodic mode the SDS011 sleeps and wakes up every N minutes,
            runs the fan for 30 seconds and sends one measurement. This
            greatly extends the life of the laser and fan.

endmenu

menu "Testing"

    config AIR_QUALITY_TEST_MODE
        bool "Air Quality test mode: cycle through all levels"
        default n
        help
            Ignores the sensor for the Air Quality attribute and sends each
            Matter AirQuality value (Good ... ExtremelyPoor) for 60 seconds in
            turn, showing the value on the OLED. Used to see how a controller
            (e.g. Apple Home) labels each level. Keep disabled in normal use.

endmenu

menu "Local Display and Indicators"

    config OLED_SDA_PIN
        int "OLED I2C SDA pin"
        default 8

    config OLED_SCL_PIN
        int "OLED I2C SCL pin"
        default 9

    config OLED_I2C_ADDRESS
        hex "OLED I2C address"
        default 0x3C

    config OLED_ROTATE_180
        bool "Rotate OLED 180 degrees"
        default y

    config STATUS_LED_GPIO
        int "WS2812 data pin"
        default 10

    config STATUS_LED_COUNT
        int "Number of WS2812 LEDs"
        range 1 64
        default 6

    config STATUS_LED_BRIGHTNESS
        int "WS2812 brightness (%)"
        range 1 100
        default 50

    config LD2410_UART_RX_PIN
        int "LD2410 UART RX pin (connect to radar TX)"
        default 3

    config LD2410_UART_TX_PIN
        int "LD2410 UART TX pin (connect to radar RX)"
        default 4

    config PRESENCE_DISTANCE_CM
        int "Turn the OLED on when someone is closer than (cm)"
        range 30 600
        default 120

    config PRESENCE_HOLD_SEC
        int "Keep the OLED on after the person leaves (seconds)"
        range 0 3600
        default 60

    config RADAR_TIMEOUT_SEC
        int "Ignore radar data older than (seconds)"
        range 1 300
        default 30

endmenu
```

## ESP32-C3/matter-wifi/matter-rgb-light-ws2812/main/Kconfig.projbuild
```kconfig
menu "Device Information"

    config DEVICE_VENDOR_NAME
        string "Manufacturer (Basic Information VendorName)"
        default "Haxeko"
        help
            Shown as Manufacturer by Apple Home, Google Home, Home Assistant... Max 32 characters.

    config DEVICE_PRODUCT_NAME
        string "Model (Basic Information ProductName)"
        default "Vibe Light"
        help
            Shown as Model. Max 32 characters.

    config DEVICE_DISPLAY_NAME
        string "Device name (Basic Information NodeLabel / ProductLabel)"
        default "Vibe Light"
        help
            Default name that controllers show when the device is added.
            Max 32 characters. It can be renamed later in the app.

endmenu

menu "WS2812 RGB Light"

    config LED_GPIO
        int "WS2812 data GPIO"
        range 0 21
        default 4
        help
            GPIO connected to DIN of the first WS2812.

    config LED_COUNT
        int "Number of WS2812 LEDs"
        range 1 1024
        default 30

    config LED_FIXED_BRIGHTNESS_PERCENT
        int "Fixed intensity of every lit LED (%)"
        range 1 100
        default 30
        help
            Each lit LED always shines at this intensity. The brightness set from
            Matter (0-100 %) does not dim the LEDs: it chooses how many LEDs are lit
            (100 % = all LEDs, 50 % = half of them, ...).

    config LED_FILL_REVERSE
        bool "Light LEDs from the end of the strip"
        default n
        help
            By default LEDs are lit starting at the first LED (next to DIN).

endmenu

menu "Button"

    config APP_BUTTON_GPIO
        int "Button GPIO (active low)"
        range -1 21
        default 9
        help
            Short press: toggle the light. Hold 5 s, then release: factory reset.
            GPIO9 is the BOOT button on ESP32-C3 boards (SuperMini, DevKitM-1). -1 disables the button.

endmenu

menu "Wi-Fi Power Save"

    config WIFI_NO_POWER_SAVE
        bool "Mains powered: no Wi-Fi power save once commissioned"
        default y
        help
            ESP-IDF starts Wi-Fi in modem sleep: the radio sleeps between the router's DTIM beacons, so
            commands and mDNS queries from controllers wait for the next beacon. On mains power this is
            not needed: once commissioning is over and Bluetooth is off, power save is turned off
            (WIFI_PS_NONE) and the radio stays on, for a few tens of mA more. While Bluetooth runs
            (BLE commissioning), Wi-Fi stays in modem sleep, which ESP-IDF requires when both share
            the radio. n: keep the ESP-IDF default (modem sleep) all the time.

endmenu
```
