## ESP32-S2/matter-wifi/matter-presence-ld2410/main/Kconfig.projbuild
```kconfig
menu "Device Information"

    config DEVICE_VENDOR_NAME
        string "Manufacturer (Basic Information VendorName)"
        default "Haxeko"

    config DEVICE_PRODUCT_NAME
        string "Model (Basic Information ProductName)"
        default "ESP32S2 LD2410"

    config DEVICE_DISPLAY_NAME
        string "Device name (Basic Information NodeLabel / ProductLabel)"
        default "Presence Sensor"
        help
            Default name that controllers show when the device is added.
            Max 32 characters. It can be renamed later in the app.

endmenu

menu "Presence Sensor Configuration"

    config LD2410_UART_RX_PIN
        int "ESP32 UART RX pin (connect to LD2410 TX)"
        range 0 46
        default 33

    config LD2410_UART_TX_PIN
        int "ESP32 UART TX pin (connect to LD2410 RX)"
        range 0 45
        default 18

    config PRESENCE_MAX_DISTANCE_CM
        int "Only count targets closer than (cm, 0 = use the radar's own gates)"
        range 0 800
        default 0
        help
            The LD2410 decides presence with its own per-gate sensitivity
            (default up to 6 m). A non-zero value additionally ignores targets
            further away than this distance.

    config RADAR_TIMEOUT_SEC
        int "Report unoccupied when the radar sends nothing for (seconds)"
        range 1 300
        default 10

    config STATUS_LED_GPIO
        int "Status LED pin (-1 = none)"
        range -1 45
        default 15
        help
            Single-colour LED. GPIO15 is the blue LED of the LOLIN S2 Mini.
            Fast blink: Wi-Fi setup. Slow blink: the pairing window is open.
            Otherwise it is on while the radar sees someone.
            The build checks that the pins of the LED, the button and the
            LD2410 differ and can be used (not GPIO19/20 of the USB console,
            nor GPIO26-32 of the flash and PSRAM).

    config STATUS_LED_ACTIVE_HIGH
        bool "Status LED is on when the pin is high"
        default y

    config RESET_BUTTON_GPIO
        int "Factory reset button pin (-1 = none)"
        range -1 46
        default 0
        help
            Holding this button (active low) for 5 seconds erases Wi-Fi and
            Matter pairing. GPIO0 is the BOOT button.

endmenu

menu "Wi-Fi Setup"

    config DIAG_BOOT_WINDOW_SEC
        int "Show the last reset reason before the setup page starts (seconds)"
        range 0 60
        default 10
        help
            While Wi-Fi is not configured, the LED first blinks the reason of
            the previous reset (1 normal, 2 brownout, 3 crash, 4 watchdog) and
            the log repeats the reset history, before the radio starts. This
            diagnoses boards that reset as soon as they transmit. 0 starts the
            setup page at once.

    config WIFI_MAX_TX_POWER
        int "Maximum Wi-Fi transmit power (unit 0.25 dBm)"
        range 8 84
        default 34
        help
            34 = 8.5 dBm. Many small ESP32-S2 boards (LOLIN S2 Mini...) cannot
            keep a Wi-Fi connection at the default ~20 dBm because of their
            antenna and 3.3 V regulator, so the power is limited. If the
            board is good and you need more range, raise it, e.g. 52
            (13 dBm) or 78 (19.5 dBm).

    config WIFI_SETUP_AP_PREFIX
        string "Setup access point name prefix"
        default "Presence-"
        help
            While the device has no Wi-Fi, it opens the access point
            "<prefix><last 4 digits of the MAC>" with a setup page at
            http://192.168.4.1. Max 28 characters (checked by the build).

    config WIFI_SETUP_AP_PASSWORD
        string "Setup access point password (empty = open)"
        default ""
        help
            Leave empty for an open setup network, or use 8 to 63 characters
            (checked by the build).

endmenu
```

## ESP32-S2/matter-wifi/matter-presence-ld2410/sdkconfig.defaults
```kconfig
CONFIG_IDF_TARGET="esp32s2"
CONFIG_ESPTOOLPY_FLASHSIZE_4MB=y

# ESP32-S2 has no Bluetooth: Wi-Fi is configured through the setup page
# (main/wifi_setup.cpp), then the device is commissioned on-network.
# The setup page needs the soft-AP; the Matter stack's own AP stays off.
CONFIG_ESP_WIFI_SOFTAP_SUPPORT=y
CONFIG_ENABLE_WIFI_AP=n

# Log console on the native USB port (LOLIN S2 Mini and other boards without a
# USB-UART chip). For a board with a USB-UART chip on GPIO43/44 use
# CONFIG_ESP_CONSOLE_UART_DEFAULT=y instead.
CONFIG_ESP_CONSOLE_USB_CDC=y

# Use the PSRAM of ESP32-S2FN4R2 / WROVER modules when present, and keep
# running from internal RAM when it is not.
CONFIG_SPIRAM=y
CONFIG_SPIRAM_IGNORE_NOTFOUND=y
CONFIG_SPIRAM_USE_MALLOC=y

#enable lwip ipv6 autoconfig
CONFIG_LWIP_IPV6_AUTOCONFIG=y

# Use a custom partition table
CONFIG_PARTITION_TABLE_CUSTOM=y
CONFIG_PARTITION_TABLE_FILENAME="partitions.csv"
CONFIG_PARTITION_TABLE_OFFSET=0xC000

#enable lwIP route hooks
CONFIG_LWIP_HOOK_IP6_ROUTE_DEFAULT=y
CONFIG_LWIP_HOOK_ND6_GET_GW_DEFAULT=y

# Enable HKDF in mbedtls
CONFIG_MBEDTLS_HKDF_C=y

# Increase LwIP IPv6 address number to 6 (MAX_FABRIC + 1)
# unique local addresses for fabrics(MAX_FABRIC), a link local address(1)
CONFIG_LWIP_IPV6_NUM_ADDRESSES=6

# Enable OTA Requestor
CONFIG_ENABLE_OTA_REQUESTOR=y

# Manufacturer / Model / Serial number come from main/device_info.cpp
CONFIG_CUSTOM_DEVICE_INSTANCE_INFO_PROVIDER=y

# RAM optimizations (esp-matter docs/en/optimizations.rst). On ESP32-S2 the
# internal SRAM is shared between code (IRAM) and data, so moving the Wi-Fi
# hot paths out of IRAM directly increases the heap.
CONFIG_ESP_MATTER_MAX_DYNAMIC_ENDPOINT_COUNT=2
CONFIG_ESP_WIFI_IRAM_OPT=n
CONFIG_ESP_WIFI_RX_IRAM_OPT=n

# Exclude unused clusters to optimize flash and memory usage
CONFIG_SUPPORT_ACCOUNT_LOGIN_CLUSTER=n
CONFIG_SUPPORT_ACTIVATED_CARBON_FILTER_MONITORING_CLUSTER=n
CONFIG_SUPPORT_AIR_QUALITY_CLUSTER=n
CONFIG_SUPPORT_APPLICATION_BASIC_CLUSTER=n
CONFIG_SUPPORT_APPLICATION_LAUNCHER_CLUSTER=n
CONFIG_SUPPORT_AUDIO_OUTPUT_CLUSTER=n
CONFIG_SUPPORT_BOOLEAN_STATE_CONFIGURATION_CLUSTER=n
CONFIG_SUPPORT_BRIDGED_DEVICE_BASIC_INFORMATION_CLUSTER=n
CONFIG_SUPPORT_CAMERA_AV_SETTINGS_USER_LEVEL_MANAGEMENT_CLUSTER=n
CONFIG_SUPPORT_CARBON_DIOXIDE_CONCENTRATION_MEASUREMENT_CLUSTER=n
CONFIG_SUPPORT_CARBON_MONOXIDE_CONCENTRATION_MEASUREMENT_CLUSTER=n
CONFIG_SUPPORT_CHANNEL_CLUSTER=n
CONFIG_SUPPORT_CHIME_CLUSTER=n
CONFIG_SUPPORT_CLOSURE_CONTROL_CLUSTER=n
CONFIG_SUPPORT_CLOSURE_DIMENSION_CLUSTER=n
CONFIG_SUPPORT_COMMISSIONER_CONTROL_CLUSTER=n
CONFIG_SUPPORT_CONTENT_LAUNCHER_CLUSTER=n
CONFIG_SUPPORT_CONTENT_CONTROL_CLUSTER=n
CONFIG_SUPPORT_CONTENT_APP_OBSERVER_CLUSTER=n
CONFIG_SUPPORT_DEVICE_ENERGY_MANAGEMENT_CLUSTER=n
CONFIG_SUPPORT_DEVICE_ENERGY_MANAGEMENT_MODE_CLUSTER=n
CONFIG_SUPPORT_DIAGNOSTIC_LOGS_CLUSTER=n
CONFIG_SUPPORT_DISHWASHER_ALARM_CLUSTER=n
CONFIG_SUPPORT_DISHWASHER_MODE_CLUSTER=n
CONFIG_SUPPORT_MICROWAVE_OVEN_MODE_CLUSTER=n
CONFIG_SUPPORT_DOOR_LOCK_CLUSTER=n
CONFIG_SUPPORT_ECOSYSTEM_INFORMATION_CLUSTER=n
CONFIG_SUPPORT_ENERGY_EVSE_CLUSTER=n
CONFIG_SUPPORT_ENERGY_EVSE_MODE_CLUSTER=n
CONFIG_SUPPORT_ENERGY_PREFERENCE_CLUSTER=n
CONFIG_SUPPORT_FAN_CONTROL_CLUSTER=n
CONFIG_SUPPORT_FAULT_INJECTION_CLUSTER=n
CONFIG_SUPPORT_FIXED_LABEL_CLUSTER=n
CONFIG_SUPPORT_FORMALDEHYDE_CONCENTRATION_MEASUREMENT_CLUSTER=n
CONFIG_SUPPORT_HEPA_FILTER_MONITORING_CLUSTER=n
CONFIG_SUPPORT_ICD_MANAGEMENT_CLUSTER=n
CONFIG_SUPPORT_KEYPAD_INPUT_CLUSTER=n
CONFIG_SUPPORT_LAUNDRY_WASHER_MODE_CLUSTER=n
CONFIG_SUPPORT_LOCALIZATION_CONFIGURATION_CLUSTER=n
CONFIG_SUPPORT_LOW_POWER_CLUSTER=n
CONFIG_SUPPORT_MEDIA_INPUT_CLUSTER=n
CONFIG_SUPPORT_MEDIA_PLAYBACK_CLUSTER=n
CONFIG_SUPPORT_MICROWAVE_OVEN_CONTROL_CLUSTER=n
CONFIG_SUPPORT_MESSAGES_CLUSTER=n
CONFIG_SUPPORT_MODE_SELECT_CLUSTER=n
CONFIG_SUPPORT_NITROGEN_DIOXIDE_CONCENTRATION_MEASUREMENT_CLUSTER=n
CONFIG_SUPPORT_SAMPLE_MEI_CLUSTER=n
CONFIG_SUPPORT_OPERATIONAL_STATE_CLUSTER=n
CONFIG_SUPPORT_OPERATIONAL_STATE_OVEN_CLUSTER=n
CONFIG_SUPPORT_OPERATIONAL_STATE_RVC_CLUSTER=n
CONFIG_SUPPORT_OVEN_MODE_CLUSTER=n
CONFIG_SUPPORT_OZONE_CONCENTRATION_MEASUREMENT_CLUSTER=n
CONFIG_SUPPORT_PM10_CONCENTRATION_MEASUREMENT_CLUSTER=n
CONFIG_SUPPORT_PM1_CONCENTRATION_MEASUREMENT_CLUSTER=n
CONFIG_SUPPORT_PM2_5_CONCENTRATION_MEASUREMENT_CLUSTER=n
CONFIG_SUPPORT_POWER_SOURCE_CLUSTER=n
CONFIG_SUPPORT_POWER_SOURCE_CONFIGURATION_CLUSTER=n
CONFIG_SUPPORT_PUMP_CONFIGURATION_AND_CONTROL_CLUSTER=n
CONFIG_SUPPORT_RADON_CONCENTRATION_MEASUREMENT_CLUSTER=n
CONFIG_SUPPORT_REFRIGERATOR_ALARM_CLUSTER=n
CONFIG_SUPPORT_REFRIGERATOR_AND_TEMPERATURE_CONTROLLED_CABINET_MODE_CLUSTER=n
CONFIG_SUPPORT_RVC_CLEAN_MODE_CLUSTER=n
CONFIG_SUPPORT_RVC_RUN_MODE_CLUSTER=n
CONFIG_SUPPORT_SERVICE_AREA_CLUSTER=n
CONFIG_SUPPORT_SMOKE_CO_ALARM_CLUSTER=n
CONFIG_SUPPORT_SOFTWARE_DIAGNOSTICS_CLUSTER=n
CONFIG_SUPPORT_SWITCH_CLUSTER=n
CONFIG_SUPPORT_TARGET_NAVIGATOR_CLUSTER=n
CONFIG_SUPPORT_TEMPERATURE_CONTROL_CLUSTER=n
CONFIG_SUPPORT_THERMOSTAT_CLUSTER=n
CONFIG_SUPPORT_THERMOSTAT_USER_INTERFACE_CONFIGURATION_CLUSTER=n
CONFIG_SUPPORT_THREAD_BORDER_ROUTER_MANAGEMENT_CLUSTER=n
CONFIG_SUPPORT_THREAD_NETWORK_DIRECTORY_CLUSTER=n
CONFIG_SUPPORT_TIME_FORMAT_LOCALIZATION_CLUSTER=n
CONFIG_SUPPORT_TIME_SYNCHRONIZATION_CLUSTER=n
CONFIG_SUPPORT_TIMER_CLUSTER=n
CONFIG_SUPPORT_TVOC_CONCENTRATION_MEASUREMENT_CLUSTER=n
CONFIG_SUPPORT_UNIT_TESTING_CLUSTER=n
CONFIG_SUPPORT_USER_LABEL_CLUSTER=n
CONFIG_SUPPORT_VALVE_CONFIGURATION_AND_CONTROL_CLUSTER=n
CONFIG_SUPPORT_WAKE_ON_LAN_CLUSTER=n
CONFIG_SUPPORT_LAUNDRY_WASHER_CONTROLS_CLUSTER=n
CONFIG_SUPPORT_LAUNDRY_DRYER_CONTROLS_CLUSTER=n
CONFIG_SUPPORT_WIFI_NETWORK_MANAGEMENT_CLUSTER=n
CONFIG_SUPPORT_WINDOW_COVERING_CLUSTER=n
CONFIG_SUPPORT_WATER_HEATER_MANAGEMENT_CLUSTER=n
CONFIG_SUPPORT_WATER_HEATER_MODE_CLUSTER=n
CONFIG_SUPPORT_ELECTRICAL_GRID_CONDITIONS_CLUSTER=n
CONFIG_SUPPORT_COMMODITY_PRICE_CLUSTER=n
CONFIG_SUPPORT_METER_IDENTIFICATION_CLUSTER=n
CONFIG_SUPPORT_UNIT_LOCALIZATION_CLUSTER=n
CONFIG_SUPPORT_COMMODITY_METERING_CLUSTER=n
CONFIG_SUPPORT_COMMODITY_TARIFF_CLUSTER=n
CONFIG_SUPPORT_PUSH_AV_STREAM_TRANSPORT_CLUSTER=n

CONFIG_SUPPORT_GROUPCAST_CLUSTER=n
CONFIG_SUPPORT_ELECTRICAL_ENERGY_MEASUREMENT_CLUSTER=n
CONFIG_SUPPORT_ELECTRICAL_POWER_MEASUREMENT_CLUSTER=n
CONFIG_SUPPORT_POWER_TOPOLOGY_CLUSTER=n
```

## ESP32-S2/matter-wifi/matter-rgb-light-ws2812/main/Kconfig.projbuild
```kconfig
menu "WS2812 RGB Light"

    config LED_GPIO
        int "WS2812 data GPIO"
        range 0 46
        default 8
        help
            GPIO connected to DIN of the first WS2812.

    config LED_COUNT
        int "Number of WS2812 LEDs"
        range 1 1024
        default 64

    config LED_FIXED_BRIGHTNESS_PERCENT
        int "Fixed intensity of every lit LED (%)"
        range 1 100
        default 30
        help
            Each lit LED always shines at this intensity. The brightness set from
            Matter (0-100 %) does not dim the LEDs: it chooses how many LEDs are lit
            (100 % = all LEDs, 50 % = half of them, ...).

    config LED_FILL_REVERSE
        bool "Light LEDs from the end of the strip"
        default n
        help
            By default LEDs are lit starting at the first LED (next to DIN).

endmenu

menu "Button"

    config APP_BUTTON_GPIO
        int "Button GPIO (active low)"
        range -1 46
        default 0
        help
            Short press: toggle the light. Hold 5 s: factory reset.
            GPIO0 is the BOOT button on most ESP32-S2 boards. -1 disables the button.

endmenu
```
