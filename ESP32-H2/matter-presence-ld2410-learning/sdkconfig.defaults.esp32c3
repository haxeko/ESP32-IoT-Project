## ESP32-H2/matter-thread/matter-door-sensor/main/Kconfig.projbuild
```kconfig
menu "Door contact"

    config CONTACT_GPIO
        int "Contact GPIO (LP IO)"
        range 7 14
        default 10
        help
            GPIO of the button net, where the reed switch goes (BTN_SW to GND, in parallel with SW1 or in its
            place). It must be an LP IO (GPIO7..GPIO14 on ESP32-H2; GPIO8..GPIO14 are bonded out): with the
            digital peripherals powered down in Light-sleep only an LP IO (EXT1) can wake the chip. Avoid
            GPIO8/GPIO9 (strapping, boot mode: a reed closed at power-up would select download mode) and
            GPIO13/GPIO14 if a 32.768 kHz crystal is fitted. GPIO10 is module pin 5 of ESP32-H2-WROOM-02C and
            chip pin 12 of the chip-down board.

    config CONTACT_INTERNAL_PULLUP
        bool "Use the internal pull-up (~45 kOhm) instead of an external one"
        default n
        help
            The reference board has a 1 MOhm pull-up to 3V3 (R6: 3.3 uA while the reed is closed) and
            1 kOhm + 1 nF in series for ESD / bounce filtering. The internal pull-up draws 73 uA while the reed
            is closed (a normally open reed on a closed door: all the time, ~60 % of the battery life) and
            cannot wake the chip from Deep-sleep.

    config CONTACT_CLOSED_WHEN_LOW
        bool "Normally open reed: the magnet closes it (door closed = input low)"
        default y
        help
            y: normally open (Form A) reed, the common kind and the one in most "magnetic contact" modules. The
            magnet at the reed (door closed) closes it and pulls the input low; 3.3 uA flow through R6 while the
            door is closed.
            n: normally closed (Form B, or the NC contact of a Form C) reed: it opens at the magnet, so the
            current flows only while the door is open.

    config CONTACT_DEBOUNCE_MS
        int "Debounce time (ms)"
        range 5 500
        default 50
        help
            The level is sampled once this long after the first edge; the interrupt stays off meanwhile. Reed
            switches bounce for under 1 ms; a slamming door shakes the magnet for a few tens of ms.

    config CONTACT_GESTURE_CHANGES
        int "Magnet gesture: contact changes (0 = off)"
        range 0 16
        default 10
        help
            This many changes (open or close) within CONTACT_GESTURE_WINDOW_MS open a commissioning window:
            moving the magnet away from the sensor and back 5 times. With a fabric: Thread/DNS-SD only, the
            original setup code, for a second controller; without one: BLE + DNS-SD. Each change is also
            reported, so an automation on the door runs as often.

    config CONTACT_GESTURE_WINDOW_MS
        int "Magnet gesture: time window (ms)"
        range 2000 30000
        default 10000
        help
            A door opened and closed by hand changes at most every 1-2 s; 10 changes in 10 s is a hand moving
            a magnet.

    config CONTACT_FORCE_EVENT_DELIVERY
        bool "Send StateChange events at once to every subscriber"
        default y
        help
            Events are sent right away only to controllers that subscribed to them as urgent; others would get
            them at the next report (up to the ICD IdleModeDuration). This asks the reporting engine for an
            immediate report after each event (the subscription's min interval still applies). The StateValue
            attribute is reported at once in any case.

    config POWER_CYCLE_RESET_COUNT
        int "Factory reset: battery insertions in a row (0 = off)"
        range 0 10
        default 5
        help
            Insert the battery this many times, each time taking it out again within POWER_CYCLE_WINDOW_S
            (wait ~2 s before the next insertion, so the chip really powers off): factory reset at the last
            insertion. Only power-on resets count; any other reset (Deep-sleep wakeup, brownout of a weak cell,
            software) starts again from 0.

    config POWER_CYCLE_WINDOW_S
        int "Factory reset: take the battery out within (s)"
        range 3 60
        default 10

endmenu

menu "Power and Thread"

    config APP_LIGHT_SLEEP
        bool "Automatic Light-sleep"
        depends on FREERTOS_USE_TICKLESS_IDLE
        default y
        help
            Off only for debugging with a console (the UART cannot wake the chip).

    config APP_UNCOMMISSIONED_DEEP_SLEEP
        bool "Deep-sleep while not commissioned and no commissioning window is open"
        depends on !CONTACT_INTERNAL_PULLUP
        default y
        help
            esp-matter keeps the BLE controller initialised until the device has a fabric, and with the main XTAL as
            the BLE low-power clock (CONFIG_BT_LE_LP_CLK_SRC_MAIN_XTAL: the module board has no 32 kHz crystal)
            Light-sleep then draws ~4 mA instead of ~25 uA (ESP-IDF nimble power_save README, ESP32-H2): a quarter
            of a CR2032 per night for a device nobody paired. With this option the device goes to Deep-sleep (~7 uA)
            60 s after its commissioning window closed without a commissioning; opening or closing the door (EXT1
            wake on the next contact change, external pull-up) restarts it into a normal boot with a new 15 min
            window. Off (debug build): stays awake.

    config THREAD_TX_POWER_DBM
        int "802.15.4 TX power (dBm)"
        range -24 20
        default 0
        help
            ESP32-H2 TX current (datasheet, 3.3 V): 36 mA at 0 dBm, 60 mA at 9 dBm, 140 mA at 20 dBm.
            The ESP-IDF driver starts at +20 dBm, far beyond what a CR2032 delivers: this value is
            applied as soon as the driver is initialised (before the first frame) and after every
            re-attach.

    config THREAD_PAUSE_WHEN_DETACHED
        bool "Pause Thread when the network is gone for long"
        default y
        help
            OpenThread retries to attach with a backoff up to 20 min (each attempt ~2 s of RX at
            25 mA). After THREAD_DETACHED_PAUSE_MIN without a parent Thread is paused and retried
            every THREAD_RETRY_MIN_MIN, doubling up to THREAD_RETRY_MAX_MIN. A door movement retries
            at once (the state is reported once attached).

    config THREAD_DETACHED_PAUSE_MIN
        int "Detached time before pausing Thread (min)"
        depends on THREAD_PAUSE_WHEN_DETACHED
        range 5 240
        default 30

    config THREAD_RETRY_MIN_MIN
        int "First retry interval while paused (min)"
        depends on THREAD_PAUSE_WHEN_DETACHED
        range 5 240
        default 30

    config THREAD_RETRY_MAX_MIN
        int "Longest retry interval while paused (min)"
        depends on THREAD_PAUSE_WHEN_DETACHED
        range 30 1440
        default 240

    config THREAD_RETRY_ATTACH_WINDOW_S
        int "Attach time allowed after a retry (s)"
        depends on THREAD_PAUSE_WHEN_DETACHED
        range 10 600
        default 20
        help
            Resuming Thread restarts the OpenThread attach backoff at 251 ms (then 0.5, 1, 2, 4 s ...),
            and every attempt keeps the receiver on for 2 s (Parent Requests to routers, then to
            REEDs: ~50 mC). 20 s is enough to restore the former parent or attach to a new one
            (~2-5 s when a router answers) and limits a failed retry to ~5 attempts.

    config THREAD_KICK_AFTER_S
        int "Restart the attach on a door movement when detached longer than (s)"
        depends on THREAD_PAUSE_WHEN_DETACHED
        range 10 3600
        default 60

    config APP_OTA_QUERY_INTERVAL_H
        int "Matter OTA query interval (hours)"
        depends on ENABLE_OTA_REQUESTOR
        range 1 720
        default 24

endmenu

menu "Battery"

    config BATTERY_SENSE_GPIO
        int "VBAT sense ADC GPIO"
        range 1 5
        default 1
        help
            ADC1 pin (GPIO1..GPIO5 on ESP32-H2) fed from VBAT through 1 MOhm, 100 nF to GND.

    config BATTERY_SENSE_RATIO_X1000
        int "VBAT / pin voltage ratio x 1000"
        range 1000 4000
        default 1000
        help
            1000 without divider (reference board: VBAT <= 3.3 V fits the ADC 12 dB range).

    choice BATTERY_TYPE
        prompt "Cell"
        default BATTERY_CR2032
        help
            Same circuit for both; a CR2450 needs a CR2450 holder (or wires to the BT1 pads). Sets the Power Source
            BatIECDesignation and the default capacity.

        config BATTERY_CR2032
            bool "CR2032 (220 mAh)"
        config BATTERY_CR2450
            bool "CR2450 (620 mAh)"
    endchoice

    config BATTERY_IEC_DESIGNATION
        string
        default "CR2450" if BATTERY_CR2450
        default "CR2032"

    config BATTERY_CAPACITY_MAH
        int "Nominal capacity (mAh), Power Source BatCapacity"
        default 620 if BATTERY_CR2450
        default 220

    config BATTERY_MODEL_FLOOR_PERCENT
        int "Lowest percentage shown from the charge count (%)"
        range 0 50
        default 20
        help
            BatPercentRemaining falls evenly from 100 % to this value over BATTERY_CAPACITY_MAH x (100 - this) %
            of charge used, then stays there: only the measured rest voltage takes it lower, once the cell leaves
            its plateau (main/battery_gauge.cpp). 0: the count alone runs down to 0 %.

    config BATTERY_MODEL_AVG_UA
        int "Modelled average current at the cell (uA)"
        range 5 5000
        default 60
        help
            BatPercentRemaining is the charge used (running time x this current) out of the usable capacity,
            bounded by the rest voltage near the end of life. 60 uA: SIT, 1 controller, ~20 door movements a day
            (button README 1.5). Set it to the average measured at JP1 (checklist F5) for an accurate percentage.

    config BATTERY_QUIET_MIN
        int "Quiet radio time before a rest reading (min)"
        range 1 120
        default 10
        help
            A rest reading waits until no commissioning window or OTA download is running and nothing has loaded
            the cell (boot, Thread attach, door report) for this long: a CR2032 reads low for minutes after
            the 25-40 mA bursts. After a battery change the values reported before (saved in NVS) are shown until
            this first reading; the boot reading only feeds the boot guard.

    config BATTERY_DROP_CONFIRM_COUNT
        int "Lower rest readings in a row before the reported percentage drops"
        range 1 10
        default 3
        help
            A reading giving the same or a higher percentage (recovered or new cell) is reported at once. A lower
            one is reported only once this many readings in a row are lower, as the highest of them. 1: every
            reading is reported (tests with a bench supply).

    config BATTERY_CONFIRM_INTERVAL_MIN
        int "Interval of the readings confirming a lower one (min)"
        range 10 720
        default 60
        help
            Instead of BATTERY_MEASURE_INTERVAL_H while a lower reading waits for its confirmation: with the
            defaults a real drop shows ~2 h after the first lower reading. Also the spacing of the two follow-up
            readings after the first reading after a boot (that one may come before the cell recovered from a
            commissioning or a flash; a higher reading is reported at once).

    config BATTERY_MEASURE_INTERVAL_H
        int "Rest voltage measurement interval (hours)"
        range 1 168
        default 12

    config BATTERY_TEST_INTERVAL_H
        int "Internal resistance load test interval (hours)"
        range 1 168
        default 24
        help
            A multiple of BATTERY_MEASURE_INTERVAL_H. The test loads the cell with the CPU for
            BATTERY_TEST_LOAD_MS (~7 mC per test).

    config BATTERY_TEST_LOAD_MS
        int "Load test duration (ms)"
        range 200 2000
        default 500

    config BATTERY_BURST_RATIO_X100
        int "Radio burst / test load battery current ratio x 100"
        range 100 1000
        default 250
        help
            Assumption: the busy CPU draws ~15 mA from the cell, a Thread re-attach or BLE
            commissioning ~40 mA for up to 2 s. Calibrate with the measurements of the test plan.

    config BATTERY_WARNING_REST_MV
        int "Warning: rest voltage below (mV)"
        default 2750

    config BATTERY_CRITICAL_REST_MV
        int "Critical: rest voltage below (mV)"
        default 2600

    config BATTERY_WARNING_BURST_MV
        int "Warning: predicted burst voltage below (mV)"
        default 2200

    config BATTERY_CRITICAL_BURST_MV
        int "Critical: predicted burst voltage below (mV)"
        default 1950
        help
            The TPS63900 stops below ~1.65 V (UVLO falling, datasheet): below this prediction the
            next Thread re-attach is likely to brown out.

    config BATTERY_BOOT_MIN_MV
        int "Boot guard: loaded voltage at boot below (mV) -> Deep-sleep"
        default 2200

    config BATTERY_BROWNOUT_LIMIT
        int "Boot guard: brownout resets in a row -> Deep-sleep"
        range 1 20
        default 3

    config BATTERY_RECOVERY_SLEEP_S
        int "Boot guard: Deep-sleep time (s)"
        range 60 86400
        default 3600

endmenu

menu "Status LED"

    config STATUS_LED_WS2812
        bool "Addressable RGB LED (WS2812B protocol) instead of a single-colour LED"
        default n
        help
            Chip-down board (hardware-chip, sdkconfig.defaults.chip): XL-2121RGBC-WS2812B, data from GPIO12
            through 100 Ohm, supply switched by a P-MOSFET from GPIO11 (low = on; a 100 kOhm pull-up keeps it off
            through reset and sleep, as the LED draws 0.7 mA even when dark). The LED is powered only while it
            is lit and shows a colour per pattern (RMT, 800 kbit/s).

    config STATUS_LED_GPIO
        int "Status LED GPIO (-1 = none)"
        depends on !STATUS_LED_WS2812
        range -1 27
        default 22
        help
            GPIO22 (module pin 15) is a digital IO with no strapping function and no reset pull.

    config STATUS_LED_ACTIVE_LEVEL
        int "Level that lights the LED"
        depends on !STATUS_LED_WS2812
        range 0 1
        default 1

    config STATUS_LED_WS2812_DATA_GPIO
        int "RGB LED data GPIO"
        depends on STATUS_LED_WS2812
        range 0 27
        default 12
        help
            GPIO12 is chip pin 14 of the chip-down board.

    config STATUS_LED_WS2812_POWER_GPIO
        int "RGB LED supply switch GPIO (-1 = always powered)"
        depends on STATUS_LED_WS2812
        range -1 27
        default 11
        help
            GPIO11 (chip pin 13) drives the gate of the P-MOSFET. Without a switch the dark LED keeps drawing
            its supply current (0.7 mA for the XL-2121RGBC-WS2812B: about 6 Ah a year, far more than a CR2032).

    config STATUS_LED_WS2812_POWER_ON_LEVEL
        int "Level that switches the RGB LED supply on"
        depends on STATUS_LED_WS2812
        range 0 1
        default 0

    config STATUS_LED_WS2812_BRIGHTNESS
        int "RGB LED brightness (1-255)"
        depends on STATUS_LED_WS2812
        range 1 255
        default 40
        help
            Scales every colour. Each colour of the XL-2121RGBC-WS2812B draws 12 mA while its 1.5 kHz PWM is on:
            40 draws about 1.9 mA per colour on average (5.6 mA for white), from the 3.3 V rail.

    config STATUS_LED_CHANGE_FEEDBACK
        bool "Flash on every door change"
        default n
        help
            20 ms flash per change (~0.1 mC with the CPU kept awake).

endmenu

menu "Thread Diagnostics"

    config THREAD_DIAG_LOG
        bool "Log Thread addresses and SRP state until commissioned"
        default y
        help
            Every 10 s, until commissioning completes, log the Thread role, IPv6 addresses
            (link-local / mesh-local / OMR), on-mesh prefixes from the Border Router and
            the SRP host/service registration state. Stops once the device is commissioned.

endmenu

menu "Identity Diagnostics and Setup Code"

    config IDENTITY_DIAG_PERIOD_SEC
        int "Identity / Thread / Matter diagnostics period (seconds, 0 = off)"
        range 0 86400
        default 86400
        help
            Logs (tag "id_diag") at boot, at this period and on Thread, fabric and session events:
            factory MAC, IEEE EUI-64, serial number, UniqueID, discriminator, Thread role, extended
            address, partition, SRP state, fabrics, CASE sessions, subscriptions and NVS usage.
            A block costs ~0.1 s of UART time: once a day on the battery device.
            Never logs the setup passcode, private keys or the Thread network key.

    config IDENTITY_DIAG_SUBSCRIPTION_LOG
        bool "Log every subscription request, establishment and termination"
        default y

    config PRINT_ONBOARDING_CODES
        bool "Log the QR code and manual pairing code when pairing is possible"
        default y
        help
            Development aid: the QR code contains the setup passcode, turn this off in production builds.

    config UNIQUE_SETUP_CODE
        bool "Per-board random setup code stored in flash"
        depends on CUSTOM_COMMISSIONABLE_DATA_PROVIDER
        default y
        help
            Enabled by sdkconfig.defaults.unique_setup. Each board generates its own passcode,
            discriminator and SPAKE2+ salt on first use and keeps them in the partition below.

    config UNIQUE_SETUP_CODE_PARTITION
        string "Flash partition for the per-board setup code"
        depends on UNIQUE_SETUP_CODE
        default "fctry"

endmenu

menu "Device Identity"

    config DEVICE_VENDOR_NAME
        string "Manufacturer (Basic Information VendorName)"
        default "Haxeko"

    config DEVICE_PRODUCT_NAME
        string "Model (Basic Information ProductName)"
        default "Matter Door Sensor"

    config DEVICE_HARDWARE_VERSION_STRING
        string "Hardware version (Basic Information HardwareVersionString)"
        default "ESP32-H2-WROOM-02C CR2032 v1.0 reed"

    config SERIAL_NUMBER_PREFIX
        string "Serial number prefix"
        default ""
        help
            Prepended to the factory eFuse MAC (12 hex digits). At most 20 characters.

endmenu
```
