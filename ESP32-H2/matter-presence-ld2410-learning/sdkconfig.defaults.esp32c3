## ESP32-H2/matter-thread/matter-presence-occupancy-learn/main/Kconfig.projbuild
```kconfig
menu "Device Information"

    config DEVICE_VENDOR_NAME
        string "Manufacturer (Basic Information VendorName)"
        default "Haxeko"

    config DEVICE_PRODUCT_NAME
        string "Model (Basic Information ProductName)"
        default "H2 Occupancy"

    config DEVICE_DISPLAY_NAME
        string "Device name (Basic Information NodeLabel / ProductLabel)"
        default "Occupancy Sensor"
        help
            Default name that controllers show when the device is added.
            Max 32 characters. It can be renamed later in the app.

endmenu

menu "Presence Sensor Configuration"

    config LD2410_UART_RX_PIN
        int "ESP32-H2 UART RX pin (connect to LD2410 TX)"
        range 0 27
        default 11
        help
            Avoid the strapping pins (GPIO2, GPIO3, GPIO8, GPIO9, GPIO25),
            the flash pins (GPIO15-GPIO21) and the console UART pins
            (GPIO23, GPIO24).

    config LD2410_UART_TX_PIN
        int "ESP32-H2 UART TX pin (connect to LD2410 RX)"
        range 0 27
        default 12

    config PRESENCE_MAX_DISTANCE_CM
        int "Only count targets closer than (cm, 0 = use the radar's own gates)"
        range 0 800
        default 0
        help
            The LD2410 decides presence with its own per-gate sensitivity
            (default up to 6 m). A non-zero value additionally ignores targets
            further away than this distance.

    config PRESENCE_HOLD_TIME_SEC
        int "Default hold time (seconds)"
        range 1 300
        default 30
        help
            Occupancy Sensing HoldTime at first boot: how long the device keeps
            reporting "occupied" after the radar stops seeing anyone.
            Controllers (Home Assistant...) can change it later in 1-300 s;
            the new value is kept across reboots.

    config RADAR_TIMEOUT_SEC
        int "Report unoccupied when the radar sends nothing for (seconds)"
        range 1 300
        default 10

    choice STATUS_LED_TYPE
        prompt "Status LED"
        default STATUS_LED_TYPE_WS2812
        help
            Blinks blue while the device waits to be commissioned (pairing
            mode) and stays off otherwise. Blinks white when an app asks the
            device to identify itself.

        config STATUS_LED_TYPE_WS2812
            bool "Addressable WS2812 RGB LED (ESP32-H2-DevKitM-1: GPIO8)"

        config STATUS_LED_TYPE_GPIO
            bool "Single-colour LED on a GPIO"

        config STATUS_LED_TYPE_NONE
            bool "None"
    endchoice

    config STATUS_LED_GPIO
        int "Status LED pin"
        depends on !STATUS_LED_TYPE_NONE
        range 0 27
        default 8

    config STATUS_LED_ACTIVE_HIGH
        bool "Status LED is on when the pin is high"
        depends on STATUS_LED_TYPE_GPIO
        default y

    config STATUS_LED_BRIGHTNESS
        int "WS2812 brightness (1-255)"
        depends on STATUS_LED_TYPE_WS2812
        range 1 255
        default 20

    config RESET_BUTTON_GPIO
        int "Button pin (-1 = none)"
        range -1 27
        default 9
        help
            Active-low push button, GPIO9 is the BOOT button.
            Double click: pairing mode (opens the commissioning window for
            15 minutes, also to add the device to a second app).
            Hold 5 seconds: factory reset (erases the Thread network and the
            Matter pairing).

endmenu

menu "Empty Room Learning"

    config LD2410_LEARN_DELAY_SEC
        int "Delay before recording (seconds)"
        range 0 120
        default 10
        help
            Time to leave the room after choosing "Learning" in Home Assistant.
            The room must stay empty while the radar is recorded.

    config LD2410_LEARN_DURATION_SEC
        int "Recording time (seconds)"
        range 10 300
        default 30
        help
            How long the per-gate energy of the empty room is recorded.

    config LD2410_LEARN_MARGIN
        int "Margin above the recorded noise (energy 0-100)"
        range 0 50
        default 10
        help
            New threshold of each gate = highest energy recorded in the empty
            room + this margin, never below the LD2410 factory default and
            at most 100 (gate ignored).

endmenu

menu "Thread Diagnostics"

    config THREAD_DIAG_LOG
        bool "Log Thread addresses and SRP state until commissioned"
        default y
        help
            Every 10 s, until commissioning completes, log the Thread role, IPv6 addresses
            (link-local / mesh-local / OMR), on-mesh prefixes from the Border Router and
            the SRP host/service registration state. Helps find why a phone cannot reach
            the device after BLE provisioning. Stops once the device is commissioned.

endmenu

menu "Memory Monitor"

    config MEM_MONITOR_PERIOD_SEC
        int "Memory log period (seconds, 0 = only at boot)"
        range 0 86400
        default 600
        help
            Logs the free heap (now, lowest since boot, largest block) and the
            unused stack of the main tasks at boot and then at this period,
            as a warning when the heap drops below 16 KB or a stack below
            512 bytes.

endmenu
```

## ESP32-H2/matter-thread/matter-presence-occupancy/main/Kconfig.projbuild
```kconfig
menu "Device Information"

    config DEVICE_VENDOR_NAME
        string "Manufacturer (Basic Information VendorName)"
        default "Haxeko"

    config DEVICE_PRODUCT_NAME
        string "Model (Basic Information ProductName)"
        default "H2 Occupancy"

    config DEVICE_DISPLAY_NAME
        string "Device name (Basic Information NodeLabel / ProductLabel)"
        default "Occupancy Sensor"
        help
            Default name that controllers show when the device is added.
            Max 32 characters. It can be renamed later in the app.

    config DEVICE_HARDWARE_VERSION_STRING
        string "Hardware (Basic Information HardwareVersionString)"
        default "ESP32H2-LD2410"
        help
            Shown as Hardware by controllers. Max 64 characters.

endmenu

menu "Presence Sensor Configuration"

    config LD2410_UART_RX_PIN
        int "ESP32-H2 UART RX pin (connect to LD2410 TX)"
        range 0 27
        default 11
        help
            Avoid the strapping pins (GPIO2, GPIO3, GPIO8, GPIO9, GPIO25),
            the flash pins (GPIO15-GPIO21) and the console UART pins
            (GPIO23, GPIO24).

    config LD2410_UART_TX_PIN
        int "ESP32-H2 UART TX pin (connect to LD2410 RX)"
        range 0 27
        default 12

    config PRESENCE_MAX_DISTANCE_CM
        int "Only count targets closer than (cm, 0 = use the radar's own gates)"
        range 0 800
        default 0
        help
            The LD2410 decides presence with its own per-gate sensitivity
            (default up to 6 m). A non-zero value additionally ignores targets
            further away than this distance.

    config PRESENCE_HOLD_TIME_SEC
        int "Default hold time (seconds)"
        range 1 300
        default 30
        help
            Occupancy Sensing HoldTime at first boot: how long the device keeps
            reporting "occupied" after the radar stops seeing anyone.
            Controllers (Home Assistant...) can change it later in 1-300 s;
            the new value is kept across reboots.

    config RADAR_TIMEOUT_SEC
        int "Report unoccupied when the radar sends nothing for (seconds)"
        range 1 300
        default 10

    choice STATUS_LED_TYPE
        prompt "Status LED"
        default STATUS_LED_TYPE_WS2812
        help
            Blinks blue while the device waits to be commissioned (pairing
            mode) and stays off otherwise. Blinks white when an app asks the
            device to identify itself.

        config STATUS_LED_TYPE_WS2812
            bool "Addressable WS2812 RGB LED (ESP32-H2-DevKitM-1: GPIO8)"

        config STATUS_LED_TYPE_GPIO
            bool "Single-colour LED on a GPIO"

        config STATUS_LED_TYPE_NONE
            bool "None"
    endchoice

    config STATUS_LED_GPIO
        int "Status LED pin"
        depends on !STATUS_LED_TYPE_NONE
        range 0 27
        default 8

    config STATUS_LED_ACTIVE_HIGH
        bool "Status LED is on when the pin is high"
        depends on STATUS_LED_TYPE_GPIO
        default y

    config STATUS_LED_BRIGHTNESS
        int "WS2812 brightness (1-255)"
        depends on STATUS_LED_TYPE_WS2812
        range 1 255
        default 20

    config RESET_BUTTON_GPIO
        int "Button pin (-1 = none)"
        range -1 27
        default 9
        help
            Active-low push button, GPIO9 is the BOOT button.
            Double click: pairing mode (opens the commissioning window for
            15 minutes, also to add the device to a second app).
            Hold 5 seconds: factory reset (erases the Thread network and the
            Matter pairing).

endmenu

menu "Thread Diagnostics"

    config THREAD_DIAG_LOG
        bool "Log Thread addresses and SRP state until commissioned"
        default y
        help
            Every 10 s, until commissioning completes, log the Thread role, IPv6 addresses
            (link-local / mesh-local / OMR), on-mesh prefixes from the Border Router and
            the SRP host/service registration state. Helps find why a phone cannot reach
            the device after BLE provisioning. Stops once the device is commissioned.

endmenu

menu "Identity Diagnostics and Setup Code"

    config IDENTITY_DIAG_PERIOD_SEC
        int "Identity / Thread / Matter diagnostics period (seconds, 0 = off)"
        range 0 86400
        default 300
        help
            Logs (tag "id_diag") at boot, at this period and on Thread, fabric and
            session events: reset reason, factory MAC, IEEE EUI-64, serial number,
            UniqueID, discriminator, Thread role, RLOC16, extended address, ML-EID,
            partition ID, leader, network name, Ext PAN ID, channel, neighbours, MLE
            counters, on-mesh prefixes, SRP server and registration state, Matter
            fabrics (index, node ID, fabric ID, compressed fabric ID, controller
            vendor), CASE sessions, subscriptions and NVS usage.
            Never logs the setup passcode, private keys or the Thread network key.

    config IDENTITY_DIAG_SUBSCRIPTION_LOG
        bool "Log every subscription request, establishment and termination"
        default y
        help
            One line per subscription event with the fabric index, the controller
            node ID and the negotiated report intervals. Only observes: the
            subscriptions and their intervals are not changed.

    config PRINT_ONBOARDING_CODES
        bool "Log the QR code and manual pairing code when pairing is possible"
        default y
        help
            At boot when not commissioned, and when the button opens the pairing
            window. Development aid: the QR code contains the setup passcode, turn
            this off in production builds.

    config UNIQUE_SETUP_CODE
        bool "Per-board random setup code stored in flash"
        depends on CUSTOM_COMMISSIONABLE_DATA_PROVIDER
        default y
        help
            Enabled by sdkconfig.defaults.unique_setup (see README). Each board
            generates its own passcode, discriminator and SPAKE2+ salt on first use,
            computes the SPAKE2+ verifier and stores them in the partition below.
            Kept across reboots, OTA, factory reset and flashing the merged or app
            image; regenerated only after erase-flash.

    config UNIQUE_SETUP_CODE_PARTITION
        string "Flash partition for the per-board setup code"
        depends on UNIQUE_SETUP_CODE
        default "fctry"
        help
            NVS data partition, namespace "setup-code". "fctry" is otherwise unused
            by these builds and lies outside the area written by the merged image.

endmenu
```
