## ESP32-H2/matter-thread-plug-wroom-2m/main/Kconfig.projbuild
```kconfig
menu "Relay Configuration"

    config RELAY_GPIO
        int "Relay GPIO number"
        range 0 27
        default 10
        help
            GPIO that drives the relay module. Avoid the ESP32-H2 strapping pins
            (GPIO2, GPIO3, GPIO8, GPIO9, GPIO25), the flash pins (GPIO15-GPIO21),
            GPIO23/GPIO24 (UART0 console RX/TX; the ROM and bootloader log on GPIO24
            at every boot, which would chatter the relay) and GPIO26/GPIO27
            (USB D-/D+; using either as a GPIO disables the USB-Serial-JTAG console).

            GPIO10 (default) has no internal pull-up or pull-down from reset until the app
            configures it (~0.5 s: ROM, bootloader, startup). With an active-high relay driver
            (NPN/MOSFET), fit a <=10 kOhm pull-down from the relay input (or gate) to GND so the
            relay stays OFF while the pin floats. GPIO4 (JTAG MTCK) has a ~45 kOhm pull-up
            during that window: avoid it for an active-high relay. GPIO0/1/5/10-14/22 have
            no reset pull-up.

    config RELAY_ACTIVE_LEVEL
        int "Relay active level (1 = active-high, 0 = active-low)"
        range 0 1
        default 1
        help
            Level written to the relay GPIO to turn the relay ON.
            Many cheap optocoupled relay boards are active-low: set 0 for those.

    config BUTTON_GPIO
        int "Button GPIO number"
        range 0 27
        default 4
        help
            Push button between this GPIO and GND (internal pull-up enabled, pressed = LOW;
            an external 10 kOhm pull-up to 3V3 is recommended).
            1 click: toggle the relay. 3 quick clicks: open the commissioning window (pairing).
            Hold 5 s (LED flashes fast), then release: factory reset.

    config STATUS_LED_ENABLE
        bool "Status LED"
        default y
        help
            Single-colour LED on STATUS_LED_GPIO: on while the relay is ON, blinks (0.5 s)
            while pairing or for Matter Identify, flashes fast while the button is held for
            factory reset. Disable on boards without it (Identify then reports no indicator).

    config STATUS_LED_GPIO
        int "Status LED GPIO number"
        depends on STATUS_LED_ENABLE
        range 0 27
        default 5
        help
            GPIO that drives the status LED (through a series resistor, e.g. 1 kOhm).

    config STATUS_LED_ACTIVE_LEVEL
        int "Status LED active level (1 = lit at HIGH, 0 = lit at LOW)"
        depends on STATUS_LED_ENABLE
        range 0 1
        default 1
        help
            1: LED anode on the GPIO (through the resistor), cathode to GND.
            0: LED cathode on the GPIO, anode to 3V3.

    config WALL_SWITCH_ENABLE
        bool "Wall switch input"
        default y
        help
            Mechanical switch between WALL_SWITCH_GPIO and GND. The input idles HIGH (internal
            pull-up), the closed switch pulls it LOW. The relay works from the switch with or
            without a Matter network. The switch position at boot never changes the relay.

    config WALL_SWITCH_GPIO
        int "Wall switch GPIO number"
        depends on WALL_SWITCH_ENABLE
        range 0 27
        default 25
        help
            GPIO25 (default) is a strapping pin (JTAG signal source), read only when the
            JTAG_SEL_ENABLE eFuse is burned (not by default), so the switch position at
            power-up does not matter. For a long cable to the switch, add an external
            4.7-10 kOhm pull-up to 3V3 and 100 nF to GND at the pin.

    choice WALL_SWITCH_MODE
        prompt "Wall switch type"
        depends on WALL_SWITCH_ENABLE
        default WALL_SWITCH_MODE_TOGGLE
        help
            How the switch input drives the relay.

        config WALL_SWITCH_MODE_TOGGLE
            bool "Rocker switch (stays in position): every flip toggles the relay"
            help
                Both HIGH -> LOW and LOW -> HIGH toggle the relay, so the switch keeps working
                after the relay was changed from the app, whatever position it is in.

        config WALL_SWITCH_MODE_MOMENTARY
            bool "Momentary push switch (springs back): each press toggles the relay"
            help
                Only HIGH -> LOW (press) toggles the relay; the release is ignored.

    endchoice

endmenu

menu "Thread Diagnostics"

    config THREAD_DIAG_LOG
        bool "Log Thread addresses and SRP state until commissioned"
        default y
        help
            Every 10 s, until commissioning completes, log the Thread role, IPv6 addresses
            (link-local / mesh-local / OMR), on-mesh prefixes from the Border Router and
            the SRP host/service registration state. Helps find why a phone cannot reach
            the device after BLE provisioning. Stops once the device is commissioned.

endmenu

menu "Device Identity"

    config DEVICE_VENDOR_NAME
        string "Manufacturer (Basic Information VendorName)"
        default "Haxeko"
        help
            Shown as Manufacturer in Apple Home. At most 32 characters (checked at build time).

    config DEVICE_PRODUCT_NAME
        string "Model (Basic Information ProductName)"
        default "ESP32-H2"
        help
            Shown as Model in Apple Home. At most 32 characters (checked at build time).

    config DEVICE_HARDWARE_VERSION_STRING
        string "Hardware version (Basic Information HardwareVersionString)"
        default "ESP32-H2-WROOM-03"
        help
            Human-readable hardware revision, shown as "Hardware" in Home Assistant.
            Replaces the SDK default "TEST_VERSION". At most 64 characters.

    config SERIAL_NUMBER_PREFIX
        string "Serial number prefix"
        default ""
        help
            The serial number is the factory eFuse MAC address (esptool "BASE MAC"), 12 uppercase hex digits,
            unique per chip and unchanged by OTA and erase-flash. This prefix is prepended to it, e.g. "RLY-" gives
            "RLY-744DBDA1B2C3". At most 20 characters (checked at build time).

endmenu
```

## ESP32-H2/matter-thread/esp32h2_matter_contact_sensor/main/Kconfig.projbuild
```kconfig
menu "Contact sensor (reed switch)"

    config CONTACT_SENSOR_GPIO
        int "Reed switch GPIO"
        range 0 27
        default 4
        help
            GPIO wired to one side of the reed switch; the other side goes to GND. The internal pull-up of this
            GPIO is enabled, no external resistor is needed for short wires.

            GPIO4 is only a suggestion: check the pinout printed on your ESP32-H2 Mini board. It is not a
            strapping pin. Do not use GPIO6-7 and GPIO15-21 (in-package flash, not available on the module pins)
            or GPIO26-27 (USB Serial/JTAG: flashing and logs); the build stops with an error if you do. Avoid
            the strapping pins GPIO2, GPIO3, GPIO8, GPIO9 and GPIO25: a closed contact on them at power-up can
            change the boot mode. GPIO23/GPIO24 are the UART0 console pins.

    config CONTACT_ACTIVE_LOW
        bool "Contact closed (door closed) reads LOW"
        default y
        help
            y (default): a normally-open reed switch to GND. Magnet at the switch (door closed) closes the
            contact and pulls the GPIO LOW; magnet away (door open) leaves the pull-up: HIGH.
              GPIO LOW  = door closed
              GPIO HIGH = door open

            n: the opposite, for a normally-closed reed switch or a module with an inverted output:
              GPIO HIGH = door closed
              GPIO LOW  = door open

    config CONTACT_DEBOUNCE_MS
        int "Debounce time (ms)"
        range 10 500
        default 50
        help
            The contact state is accepted only after the GPIO has been quiet (no edge) for this time. Every new
            edge restarts the wait, so contact bounce and vibration are filtered out. Reed switches bounce for
            well under 5 ms; 50 ms also absorbs a door that rattles in its frame while closing. Larger values
            delay the report by the same amount.

endmenu

menu "Factory reset button"

    config FACTORY_RESET_GPIO
        int "Factory reset button GPIO"
        range 0 27
        default 9
        help
            Push button between this GPIO and GND (internal pull-up). Default GPIO9 is the BOOT button of most
            ESP32-H2 boards, but check your board: GPIO9 is a strapping pin. Holding it while the board powers up
            or resets starts the ROM download mode (no firmware runs, so no factory reset happens): press it only
            after the firmware has started.

            Must differ from the reed switch and LED pins; GPIO6-7, GPIO15-21 and GPIO26-27 are rejected at build
            time (see "Reed switch GPIO").

    config FACTORY_RESET_HOLD_MS
        int "Hold time for factory reset (ms)"
        range 3000 30000
        default 6000
        help
            Holding the button this long erases all Matter fabrics and the Thread network credentials, then
            restarts the device so it can be commissioned again. Shorter presses do nothing.

endmenu

menu "Status LED"

    config STATUS_LED_ENABLE
        bool "Status LED on a GPIO"
        default n
        help
            Optional single-color LED (with a series resistor) on a GPIO. ESP32-H2 Mini boards do not share a
            common LED pin, and boards whose LED is an addressable RGB LED (WS2812 type, often on GPIO8) cannot be
            driven as a plain GPIO LED: in that case wire an external LED to a free GPIO.

            Patterns: solid on = factory reset running; fast blink = reset button held; medium blink = Identify;
            slow blink = commissioning window open; off otherwise (or the door state, see below).

    config STATUS_LED_GPIO
        int "Status LED GPIO"
        depends on STATUS_LED_ENABLE
        range 0 27
        default 5
        help
            GPIO of the LED. GPIO5 is only a placeholder: set the pin your LED is actually wired to. Must differ
            from the reed switch and button pins.

    config STATUS_LED_ACTIVE_HIGH
        bool "LED lights when the GPIO is HIGH"
        depends on STATUS_LED_ENABLE
        default y
        help
            y: LED from the GPIO through a resistor to GND. n: LED from 3V3 to the GPIO (lights on LOW).

    config STATUS_LED_SHOW_CONTACT
        bool "LED on while the door is open"
        depends on STATUS_LED_ENABLE
        default n
        help
            When no other pattern is active, light the LED while the contact is open. Useful to check the
            wiring and the debounce on the bench.

endmenu

menu "Matter onboarding (development)"

    config CONTACT_PRINT_ONBOARDING_CODES
        bool "Print the QR code and manual pairing code on the serial console"
        default y
        help
            While the device is not commissioned, print the onboarding payload (QR code text, a URL that shows
            the QR code, and the 11-digit manual pairing code) after start-up. With the default test credentials
            these are the well-known development codes (passcode 20202021, discriminator 3840). With factory
            data from esp-matter-mfg-tool the passcode is not stored on the device, so nothing can be printed:
            use the codes printed by esp-matter-mfg-tool instead.

endmenu
```
